## nghttp2/Kconfig
```kconfig
#
# Copyright (C) 2020 Xiaomi Corporation
#
# Licensed under the Apache License, Version 2.0 (the "License");
# you may not use this file except in compliance with the License.
# You may obtain a copy of the License at
#
#      http://www.apache.org/licenses/LICENSE-2.0
#
# Unless required by applicable law or agreed to in writing, software
# distributed under the License is distributed on an "AS IS" BASIS,
# WITHOUT WARRANTIES OR CONDITIONS OF ANY KIND, either express or implied.
# See the License for the specific language governing permissions and
# limitations under the License.
#

config LIB_NGHTTP2
	bool "Enable NGHTTP2"
	default n
	---help---
		nghttp2 is an implementation of HTTP/2 and its header compression algorithm HPACK.

if LIB_NGHTTP2
config NGHTTP2_TEST
	tristate "Enable NGHTTP2 Test"
	default n
	depends on LIB_CUNIT
	---help---
		enable NGHTTP2 test.

if NGHTTP2_TEST
config NGHTTP2_TEST_PROGNAME
	string "Program name"
	default "nghttp2_test"
	---help---
		This is the name of the program that will be used when the nghttps2 test is installed.

config NGHTTP2_TEST_PRIORITY
	int "NGHTTP2 test priority"
	default 100

config NGHTTP2_TEST_STACKSIZE
	string "NGHTTP2 test stack size"
	default DEFAULT_TASK_STACKSIZE
endif

endif
```

## nng/Kconfig
```kconfig
#
# Copyright (C) 2020 Xiaomi Corporation
#
# Licensed under the Apache License, Version 2.0 (the "License");
# you may not use this file except in compliance with the License.
# You may obtain a copy of the License at
#
#      http://www.apache.org/licenses/LICENSE-2.0
#
# Unless required by applicable law or agreed to in writing, software
# distributed under the License is distributed on an "AS IS" BASIS,
# WITHOUT WARRANTIES OR CONDITIONS OF ANY KIND, either express or implied.
# See the License for the specific language governing permissions and
# limitations under the License.
#

config NNG
	bool "enable nng library"
	default n

if NNG

config NNG_DEFINES
	string "nng configuration"
	default "NNG_PLATFORM_POSIX NNG_PROTOCOL_REQREP NNG_PROTOCOL_PUBSUB NNG_TRANSPORT_INPROC"

config NNG_PTHREAD_STACKSIZE
        int "nng pthread stack size"
        default 6148

config NNG_DEMO
	tristate "enable nng demo"
	default n

endif #NNG
```

## optee/optee_examples/Kconfig
```kconfig
#
# Copyright (C) 2023 Xiaomi Corporation
#
# Licensed under the Apache License, Version 2.0 (the "License");
# you may not use this file except in compliance with the License.
# You may obtain a copy of the License at
#
#      http://www.apache.org/licenses/LICENSE-2.0
#
# Unless required by applicable law or agreed to in writing, software
# distributed under the License is distributed on an "AS IS" BASIS,
# WITHOUT WARRANTIES OR CONDITIONS OF ANY KIND, either express or implied.
# See the License for the specific language governing permissions and
# limitations under the License.
#

menu "OP-TEE CA examples"

config OPTEE_EXAMPLES_CA_HELLOWORLD
	bool "optee ca hello world example"
	depends on LIB_TEEC
	default n
	---help---
		"optee ca hello world example"

if OPTEE_EXAMPLES_CA_HELLOWORLD

config OPTEE_EXAMPLES_CA_HELLOWORLD_PROGNAME
	string "ca hello world program name"
	default "optee_example_hello_world"
	---help---
		This is the name of the optee ca hello world program.

config OPTEE_EXAMPLES_CA_HELLOWORLD_PRIORITY
	int "hello world program task priority"
	default 100

config OPTEE_EXAMPLES_CA_HELLOWORLD_STACKSIZE
	int "hello world program stack size"
	default DEFAULT_TASK_STACKSIZE

endif

endmenu


menu "OP-TEE TA examples"

config OPTEE_EXAMPLES_TA_HELLOWORLD
	bool "optee ta hello world example"
	depends on OPTEE_OS
	default n
	---help---
		"optee ta hello world example"

endmenu
```

## optee/optee_nuttx/Kconfig
```kconfig
#
# Copyright (C) 2023 Xiaomi Corporation
#
# Licensed under the Apache License, Version 2.0 (the "License");
# you may not use this file except in compliance with the License.
# You may obtain a copy of the License at
#
# http://www.apache.org/licenses/LICENSE-2.0
#
# Unless required by applicable law or agreed to in writing, software
# distributed under the License is distributed on an "AS IS" BASIS,
# WITHOUT WARRANTIES OR CONDITIONS OF ANY KIND, either express or implied.
# See the License for the specific language governing permissions and
# limitations under the License.
#

choice
	prompt "Select optee server implementation"
	default OPTEE_SERVER_NONE

config OPTEE_SERVER_LOCAL
	bool "Local socket optee server"
	depends on NET_LOCAL

config OPTEE_SERVER_RPMSG
	bool "Rmpsg socket optee server"
	depends on NET_RPMSG

config OPTEE_SERVER_NONE
	bool "Disable optee server"

endchoice

if !OPTEE_SERVER_NONE

config OPTEE_SERVER_PROGNAME
	string "Program name"
	default "opteed"
	---help---
		This is the name of the optee that will be used when the OPTEE ELF
		program is installed.

config OPTEE_SERVER_PRIORITY
	int "Task priority"
	default 100

config OPTEE_SERVER_STACKSIZE
	int "Stack size"
	default DEFAULT_TASK_STACKSIZE

config OPTEE_NATIVE_STACKSIZE
	int "Thread stack size"
	default 16384

endif

config USER_TA_WASM
	bool "Enable Ta wasm in tee"
	depends on INTERPRETERS_WAMR
	default y

config OPTEE_HOST_FS_PARENT_PATH
	string "Enable custom hostfs pathname"
	default "/sst"
```

## optee/optee_os/Kconfig
```kconfig
#
# Copyright (C) 2023 Xiaomi Corporation
#
# Licensed under the Apache License, Version 2.0 (the "License");
# you may not use this file except in compliance with the License.
# You may obtain a copy of the License at
#
#      http://www.apache.org/licenses/LICENSE-2.0
#
# Unless required by applicable law or agreed to in writing, software
# distributed under the License is distributed on an "AS IS" BASIS,
# WITHOUT WARRANTIES OR CONDITIONS OF ANY KIND, either express or implied.
# See the License for the specific language governing permissions and
# limitations under the License.
#

config OPTEE_OS
	bool "optee os"
	default n
	---help---
		"optee os"

config ENABLE_CRYPTO_SM3
	bool "sm3 crypto"
	depends on OPTEE_OS
	default n

choice
	prompt "Select optee fs"
	default OPTEE_REE_FS

config OPTEE_REE_FS
	bool "enable ree fs in optee os"

config OPTEE_RPMB_FS
	bool "enable rpmb fs in optee os"
	depends on OPTEE_OS && BLK_RPMSG

if OPTEE_RPMB_FS

config OPTEE_RPMB_REMOTE_CPU
	string "remote cpu where rpmb device is located"
	default "ap"

config OPTEE_RPMB_WRITE_KEY
	bool "enable rpmb key derived from huks(Only for testing and factory setup)"
	default n

config OPTEE_RPMB_TESTKEY
	bool "enable using the default rpmb key(Only for testing)"
	default n

config OPTEE_HUK_SUBKEY_COMPAT
	bool "enable using subkeys derived from dieid"
	default n

config OPTEE_RPMB_COMPAT_MITEE_FS
	bool "enable rpmbfs to compat with mitee fs"
	default n

endif # OPTEE_RPMB_FS

endchoice

config OPTEE_COMPAT_MITEE_FS
	bool "to compat with mitee fs"
	depends on OPTEE_OS
	default n
```

## optee/optee_test/Kconfig
```kconfig
#
# Copyright (C) 2023 Xiaomi Corporation
#
# Licensed under the Apache License, Version 2.0 (the "License");
# you may not use this file except in compliance with the License.
# You may obtain a copy of the License at
#
#      http://www.apache.org/licenses/LICENSE-2.0
#
# Unless required by applicable law or agreed to in writing, software
# distributed under the License is distributed on an "AS IS" BASIS,
# WITHOUT WARRANTIES OR CONDITIONS OF ANY KIND, either express or implied.
# See the License for the specific language governing permissions and
# limitations under the License.
#

config OPTEE_TEST_CA
	tristate "optee xtest ca"
	default n
	depends on LIB_TEEC
	---help---
		Enable optee xtest ca build

if OPTEE_TEST_CA

config OPTEE_TEST_CA_PROGNAME
	string "optee xtest ca program name"
	default "xtest"
	---help---
		This is the name of the optee xtest ta program.

config OPTEE_TEST_CA_PRIORITY
	int "optee xtest ca program task priority"
	default 100

config OPTEE_TEST_CA_STACKSIZE
	int "optee xtest ca program stack size"
	default 40960

endif # OPTEE_TEST_CA


config OPTEE_TEST_TA
	tristate "optee trusted application"
	depends on OPTEE_OS
	default n
	---help---
		"enable optee test ta"
```

## opus/Kconfig
```kconfig
#
# Copyright (C) 2020 Xiaomi Corporation
#
# Licensed under the Apache License, Version 2.0 (the "License");
# you may not use this file except in compliance with the License.
# You may obtain a copy of the License at
#
#      http://www.apache.org/licenses/LICENSE-2.0
#
# Unless required by applicable law or agreed to in writing, software
# distributed under the License is distributed on an "AS IS" BASIS,
# WITHOUT WARRANTIES OR CONDITIONS OF ANY KIND, either express or implied.
# See the License for the specific language governing permissions and
# limitations under the License.
#

comment "opus"

config LIB_OPUS
	tristate "Enable opus"
	default n

if LIB_OPUS

config LIB_OPUS_DECODE_TEST
	bool "opus decode test"
	default n

config LIB_OPUS_ENCODE_TEST
	bool "opus encode test"
	default n

config LIB_OPUS_PRIORITY
	int "task priority"
	default 80

config LIB_OPUS_STACKSIZE
	int "stack size"
	default 102400

endif # LIB_OPUS
```

## pciutils/Kconfig
```kconfig
#
# For a description of the syntax of this configuration file,
# see the file kconfig-language.txt in the NuttX tools repository.
#

config PCIUTILS
	tristate "\"pcituils\""
	default n
	---help---
		Enable the \"pciutils\"

if PCIUTILS

config PCIUTILS_PRIORITY
	int "pciutils task priority"
	default 100

config PCIUTILS_STACKSIZE
	int "pciutils stack size"
	default DEFAULT_TASK_STACKSIZE

endif
```

## protobuf-c/Kconfig
```kconfig
#
# Copyright (C) 2020 Xiaomi Corporation
#
# Licensed under the Apache License, Version 2.0 (the "License");
# you may not use this file except in compliance with the License.
# You may obtain a copy of the License at
#
#      http://www.apache.org/licenses/LICENSE-2.0
#
# Unless required by applicable law or agreed to in writing, software
# distributed under the License is distributed on an "AS IS" BASIS,
# WITHOUT WARRANTIES OR CONDITIONS OF ANY KIND, either express or implied.
# See the License for the specific language governing permissions and
# limitations under the License.
#

config PROTOBUF_C
	bool "Enable Protocol Buffer C"
	default n

if PROTOBUF_C

config PROTOBUF_C_TEST
	bool "Enable the test for protobuf-c"
	default n

if PROTOBUF_C_TEST

config PROTOBUF_C_TEST_PRIORITY
	int "PROTOBUF_C test priority"
	default 100

config PROTOBUF_C_TEST_STACKSIZE
	int "PROTOBUF_C test stack size"
	default DEFAULT_TASK_STACKSIZE

endif #PROTOBUF_C_TEST

endif #PROTOBUF_C
```

## qpoases/Kconfig
```kconfig
#
# For a description of the syntax of this configuration file,
# see the file kconfig-language.txt in the NuttX tools repository.
#

config LIB_QPOASES
	bool "qpoases library"
	default n

if LIB_QPOASES

config LIB_QPOASES_TESTCASE
	tristate "qpoases library passability test"
	default n
	---help---
		Used to check whether there will be any problems
		with the library running on NuttX

endif
```

## rapidjson/Kconfig
```kconfig
#
# For a description of the syntax of this configuration file,
# see the file kconfig-language.txt in the NuttX tools repository.
#

config LIB_RAPIDJSON
	bool "rapidjson library"
	default n

if LIB_RAPIDJSON

config LIB_RAPIDJSON_TESTCASE
	tristate "rapidjson library passability test"
	default n
	depends on LIB_GOOGLETEST
	---help---
		Used to check whether there will be any problems
		with the library running on NuttX

endif
```

## rlottie/Kconfig
```kconfig
#
# Copyright (C) 2020 Xiaomi Corporation
#
# Licensed under the Apache License, Version 2.0 (the "License");
# you may not use this file except in compliance with the License.
# You may obtain a copy of the License at
#
#      http://www.apache.org/licenses/LICENSE-2.0
#
# Unless required by applicable law or agreed to in writing, software
# distributed under the License is distributed on an "AS IS" BASIS,
# WITHOUT WARRANTIES OR CONDITIONS OF ANY KIND, either express or implied.
# See the License for the specific language governing permissions and
# limitations under the License.
#

menuconfig LIB_RLOTTIE
	bool "Enable rlottie"
	default n

if LIB_RLOTTIE

menuconfig LOTTIE_MODULE
	bool "Ebable lottie module"
	default n

if LOTTIE_MODULE

config LOTTIE_MODULE_PATH
	string "select the lottie module file path"

endif

config LOTTIE_THREAD_SUPPORT
	bool "Enable lottie thread support"
	default n

config LOTTIE_CACHE_SUPPORT
	bool "Enable lottie cache support"
	default n

config LOTTIE_LOGGING_SUPPORT
	bool "Enable lottie log support"
	default n

config LOTTIE_TEST
	tristate "LOTTIE tests"
	default n
	---help---
		Enable the LOTTIE tests

if LOTTIE_TEST

config LOTTIE_TEST_PRIORITY
	int "LOTTIE test task priority"
	default 100

config LOTTIE_TEST_STACKSIZE
	int "LOTTIE test stack size"
	default DEFAULT_TASK_STACKSIZE

endif

endif
```

## rtos-benchmark/Kconfig
```kconfig
#
# Copyright (C) 2020 Xiaomi Corporation
#
# Licensed under the Apache License, Version 2.0 (the "License");
# you may not use this file except in compliance with the License.
# You may obtain a copy of the License at
#
#      http://www.apache.org/licenses/LICENSE-2.0
#
# Unless required by applicable law or agreed to in writing, software
# distributed under the License is distributed on an "AS IS" BASIS,
# WITHOUT WARRANTIES OR CONDITIONS OF ANY KIND, either express or implied.
# See the License for the specific language governing permissions and
# limitations under the License.
#

config RTOS_BENCHMARK
	tristate "RTOS benchmark"
	default n

if RTOS_BENCHMARK

config RTOS_BENCHMARK_PROGNAME
	string "Program Name"
	default "rtosbenchmark"

config RTOS_BENCHMARK_STACKSIZE
	int "rtos_benchmark stack size"
	default DEFAULT_TASK_STACKSIZE

config RTOS_BENCHMARK_PRIORITY
	int "Task PRIORITY"
	default 100
	---help---
		The higher the priority value, the lower the priority.

config RTOS_BENCHMARK_ITERATIONS
	int "ITERATIONS"
	default 1000

config RTOS_BENCHMARK_MAXTHREADS
	int "Max Threads"
	default 10

config RTOS_BENCHMARK_MAXSEMAPHORES
	int "Max Semaphores"
	default 5

config RTOS_BENCHMARK_MAXMUTEXES
	int "Max Mutexes"
	default 5

endif
```

## sysklogd/Kconfig
```kconfig
#
# Copyright (C) 2020 Xiaomi Corporation
#
# Licensed under the Apache License, Version 2.0 (the "License");
# you may not use this file except in compliance with the License.
# You may obtain a copy of the License at
#
#      http://www.apache.org/licenses/LICENSE-2.0
#
# Unless required by applicable law or agreed to in writing, software
# distributed under the License is distributed on an "AS IS" BASIS,
# WITHOUT WARRANTIES OR CONDITIONS OF ANY KIND, either express or implied.
# See the License for the specific language governing permissions and
# limitations under the License.
#

config SYSLOGD
	tristate "syslogd"
	default n
	---help---
		Enable syslogd

if SYSLOGD

config SYSLOGD_PRIORITY
	int "syslogd task priority"
	default 100

config SYSLOGD_STACKSIZE
	int "syslogd stack size"
	default 4096

config SYSLOGD_LINE_MAX
	int "syslogd line max"
	default 256

config SYSLOGD_CONFDIR
	string "Config directory"
	default "/etc"

config SYSLOGD_STATEDIR
	string "State directory"
	default "/tmp"

endif
```
