## thorvg/Kconfig
```kconfig
#
# Copyright (C) 2023 Xiaomi Corporation
#
# Licensed under the Apache License, Version 2.0 (the "License");
# you may not use this file except in compliance with the License.
# You may obtain a copy of the License at
#
#      http://www.apache.org/licenses/LICENSE-2.0
#
# Unless required by applicable law or agreed to in writing, software
# distributed under the License is distributed on an "AS IS" BASIS,
# WITHOUT WARRANTIES OR CONDITIONS OF ANY KIND, either express or implied.
# See the License for the specific language governing permissions and
# limitations under the License.
#

menuconfig LIB_THORVG
	tristate "Enable ThorVG"
	default n

if LIB_THORVG

config THORVG_STACKSIZE
	int "thorvg stack size"
	default DEFAULT_TASK_STACKSIZE

config THORVG_PRIORITY
	int "Task PRIORITY"
	default 100
	---help---
		The higher the priority value, the lower the priority.

config THORVG_SVG_LOADER_SUPPORT
	bool "Enable svg loader"
	default y

config THORVG_PNG_LOADER_SUPPORT
	bool "Enable png loader"
	default y

config THORVG_TVG_LOADER_SUPPORT
	bool "Enable tvg loader"
	default y

config THORVG_JPG_LOADER_SUPPORT
	bool "Enable jpg loader"
	default y

config THORVG_LOTTIE_LOADER_SUPPORT
	bool "Enable lottie loader"
	default y

endif
```

## tinycrypt/Kconfig
```kconfig
#
# Copyright (C) 2020 Xiaomi Corporation
#
# Licensed under the Apache License, Version 2.0 (the "License");
# you may not use this file except in compliance with the License.
# You may obtain a copy of the License at
#
#      http://www.apache.org/licenses/LICENSE-2.0
#
# Unless required by applicable law or agreed to in writing, software
# distributed under the License is distributed on an "AS IS" BASIS,
# WITHOUT WARRANTIES OR CONDITIONS OF ANY KIND, either express or implied.
# See the License for the specific language governing permissions and
# limitations under the License.
#

menu "Crypto: TinyCrypt cryptography library"

config TINYCRYPT
  bool "TinyCrypt Support"
  help
    This option enables the TinyCrypt cryptography library.

if TINYCRYPT

config TINYCRYPT_CTR_PRNG
  bool "PRNG in counter mode"
  default n
  help
    This option enables support for the pseudo-random number
    generator in counter mode.

config TINYCRYPT_SHA256
  bool "SHA-256 Hash function support"
  default n
  help
    This option enables support for SHA-256
    hash function primitive.

config TINYCRYPT_SHA256_HMAC
  bool "HMAC (via SHA256) message auth support"
  default n
  help
    This option enables support for HMAC using SHA-256
    message authentication code.

config TINYCRYPT_SHA256_HMAC_PRNG
  bool "PRNG (via HMAC-SHA256) support"
  default n
  help
    This option enables support for pseudo-random number
    generator.

config TINYCRYPT_ECC_DH
  bool "ECC_DH anonymous key agreement protocol"
  default n
  help
    This option enables support for the Elliptic curve
    Diffie-Hellman anonymous key agreement protocol.

    Enabling ECC requires a cryptographically secure random number
    generator.

config TINYCRYPT_ECC_DSA
  bool "ECC_DSA digital signature algorithm"
  default n
  help
    This option enables support for the Elliptic Curve Digital
    Signature Algorithm (ECDSA).

    Enabling ECC requires a cryptographically secure random number
    generator.

config TINYCRYPT_AES
  bool "AES-128 decrypt/encrypt"
  default n
  help
    This option enables support for AES-128 decrypt and encrypt.

config TINYCRYPT_AES_CBC
  bool "AES-128 block cipher"
  default n
  help
    This option enables support for AES-128 block cipher mode.

config TINYCRYPT_AES_CTR
  bool "AES-128 counter mode"
  default n
  help
    This option enables support for AES-128 counter mode.

config TINYCRYPT_AES_CCM
  bool "AES-128 CCM mode"
  default n
  help
    This option enables support for AES-128 CCM mode.

config TINYCRYPT_AES_CMAC
  bool "AES-128 CMAC mode"
  default n
  help
    This option enables support for AES-128 CMAC mode.

endif

endmenu
```

## unqlite/Kconfig
```kconfig
#
# Copyright (C) 2020 Xiaomi Corporation
#
# Licensed under the Apache License, Version 2.0 (the "License");
# you may not use this file except in compliance with the License.
# You may obtain a copy of the License at
#
#      http://www.apache.org/licenses/LICENSE-2.0
#
# Unless required by applicable law or agreed to in writing, software
# distributed under the License is distributed on an "AS IS" BASIS,
# WITHOUT WARRANTIES OR CONDITIONS OF ANY KIND, either express or implied.
# See the License for the specific language governing permissions and
# limitations under the License.
#

config UNQLITE
	bool "UnQLite Database"
	default n

if UNQLITE

config SXMEM_POOL_NBUCKETS
	int "memory pool bucket number"
	default 8

config SXMEM_POOL_INCR
	int "memory pool increment step"
	default 1

config UNQLITE_LOCK_BY_SEM
	bool "use named semaphores as filelocks"
	default y
	select FS_NAMED_SEMAPHORES

config UNQLITE_ENABLE_DIRSYNC
	bool "disable upper level directory sync"
	default n

config UNQLITE_ENABLE_JX9_HASH_IO
	bool "enable built-in hash functions"
	default n

config JX9_ENABLE_DISK_IO
	bool "enable built-in VFS functions"
	default n

config JX9_ENABLE_BUILTIN_FUNC
	bool "enable built-in Jx9 functions"
	default n

config JX9_ENABLE_MATH_FUNC
	bool "enable built-in math functions"
	default n

endif # UNQLITE
```

## yaml-cpp/Kconfig
```kconfig
#
# For a description of the syntax of this configuration file,
# see the file kconfig-language.txt in the NuttX tools repository.
#

config LIB_YAMLCPP
	bool "yaml-cpp library"
	default n

if LIB_YAMLCPP

config LIB_YAMLCPP_TESTCASE
	tristate "yaml-cpp library passability test"
	default n
	---help---
		Used to check whether there will be any problems
		with the library running on NuttX

endif
```

## zint/Kconfig
```kconfig
#
# Copyright (C) 2020 Xiaomi Corporation
#
# Licensed under the Apache License, Version 2.0 (the "License");
# you may not use this file except in compliance with the License.
# You may obtain a copy of the License at
#
#      http://www.apache.org/licenses/LICENSE-2.0
#
# Unless required by applicable law or agreed to in writing, software
# distributed under the License is distributed on an "AS IS" BASIS,
# WITHOUT WARRANTIES OR CONDITIONS OF ANY KIND, either express or implied.
# See the License for the specific language governing permissions and
# limitations under the License.
#

menu "Zint Barcode Generator"

config LIB_ZINT
	bool "Enable Zint Barcode"
	default n
	---help---
		Enable the Zint Barcode

if LIB_ZINT

config UTILS_ZINT
	tristate "zint tool"
	default n
	---help---
		Enable zint utility

if UTILS_ZINT
config UTILS_ZINT_PROGNAME
	string "Programe Name"
	default "zint"

config UTILS_ZINT_PRIORITY
	int "zint utility priority"
	default 100

config UTILS_ZINT_STACKSIZE
	int "zint utility statcksize"
	default DEFAULT_TASK_STACKSIZE
endif

endif

endmenu # Zint Barcode Generator
```

## zlib/Kconfig
```kconfig
#
# Copyright (C) 2020 Xiaomi Corporation
#
# Licensed under the Apache License, Version 2.0 (the "License");
# you may not use this file except in compliance with the License.
# You may obtain a copy of the License at
#
#      http://www.apache.org/licenses/LICENSE-2.0
#
# Unless required by applicable law or agreed to in writing, software
# distributed under the License is distributed on an "AS IS" BASIS,
# WITHOUT WARRANTIES OR CONDITIONS OF ANY KIND, either express or implied.
# See the License for the specific language governing permissions and
# limitations under the License.
#

config LIB_ZLIB
	tristate "zlib data compression library"
	default n

if LIB_ZLIB

config LIB_ZLIB_TEST
	tristate "zlib test"
	default n
	help
		Enable the test for zlib.

if LIB_ZLIB_TEST

config LIB_ZLIB_TEST_PRIORITY
	int "Zlib test priority"
	default 100

config LIB_ZLIB_TEST_STACKSIZE
	int "Zlib test stack size"
	default DEFAULT_TASK_STACKSIZE

endif # LIB_ZLIB_TEST

config UTILS_GZIP
	bool "GZIP tool"
	default n
	---help---
		Enable gzip utility

if UTILS_GZIP
config UTILS_GZIP_PROGNAME
	string "Programe Name"
	default "gzip"

config UTILS_GZIP_PRIORITY
	int "gzip utility priority"
	default 100

config UTILS_GZIP_STACKSIZE
	int "gzip utility statcksize"
	default 32768
endif

config UTILS_ZIP
	bool "ZIP tool"
	default n
	---help---
		Enable zip utility

if UTILS_ZIP
config UTILS_ZIP_PROGNAME
	string "Programe Name"
	default "zip"

config UTILS_ZIP_PRIORITY
	int "zip utility priority"
	default 100

config UTILS_ZIP_STACKSIZE
	int "zip utility statcksize"
	default 32768
endif

config UTILS_UNZIP
	bool "UNZIP tool"
	default n
	---help---
		Enable unzip utility

if UTILS_UNZIP
config UTILS_UNZIP_PROGNAME
	string "Programe Name"
	default "unzip"

config UTILS_UNZIP_PRIORITY
	int "unzip utility priority"
	default 100

config UTILS_UNZIP_STACKSIZE
	int "unzip utility statcksize"
	default 32768
endif

endif
```
