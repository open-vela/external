## freetype/Kconfig
```kconfig
#
# Copyright (C) 2021 Xiaomi Corporation
#
# Licensed under the Apache License, Version 2.0 (the "License");
# you may not use this file except in compliance with the License.
# You may obtain a copy of the License at
#
#      http://www.apache.org/licenses/LICENSE-2.0
#
# Unless required by applicable law or agreed to in writing, software
# distributed under the License is distributed on an "AS IS" BASIS,
# WITHOUT WARRANTIES OR CONDITIONS OF ANY KIND, either express or implied.
# See the License for the specific language governing permissions and
# limitations under the License.
#

menuconfig LIB_FREETYPE
	bool "Enable FreeType"
	depends on ARCH_SETJMP_H
	default n

if LIB_FREETYPE

config LIB_FREETYPE_MEMSIZE
	int "Size of the custom memory used by `ft_alloc/ft_realloc/ft_free` in kilobytes"
	default 0

menuconfig LIB_FREETYPE_MBFC
	bool "Enable Multi-block file cache read"
	default n

if LIB_FREETYPE_MBFC

config LIB_FREETYPE_MBFC_BLOCK_SIZE
	int "Size of a block in the Multi-block cache read in bytes"
	default 16384

config LIB_FREETYPE_MBFC_CACHE_NUM
	int "Maximum number of cache blocks"
	default 16

config LIB_FREETYPE_MBFC_DEBUG
	bool "Enable debugging messages"
	default n

endif # LIB_FREETYPE_MBFC

menu "Font modules"

config LIB_FREETYPE_FONT_MODULES_TRUETYPE
	bool "TrueType font driver"
	default y
	depends on LIB_FREETYPE_FONT_MODULES_SFNT
	help
		This driver needs the `sfnt' module.

config LIB_FREETYPE_FONT_MODULES_TYPE1
	bool "PostScript Type 1 font driver"
	default n
	depends on LIB_FREETYPE_AUX_MODULES_PSAUX
	depends on LIB_FREETYPE_AUX_MODULES_PSNAMES
	depends on LIB_FREETYPE_HINTING_MODULES_PSHINTER
	help
		This driver needs the `psaux', `pshinter', and `psnames' modules.

config LIB_FREETYPE_FONT_MODULES_CFF
	bool "CFF/OpenType font driver"
	default y
	depends on LIB_FREETYPE_FONT_MODULES_SFNT
	depends on LIB_FREETYPE_AUX_MODULES_PSAUX
	depends on LIB_FREETYPE_AUX_MODULES_PSNAMES
	depends on LIB_FREETYPE_AUX_MODULES_OTVALID
	depends on LIB_FREETYPE_HINTING_MODULES_PSHINTER
	help
		This driver needs the `sfnt', `psaux', `pshinter', and `psnames' modules.

config LIB_FREETYPE_FONT_MODULES_CID
	bool "Type 1 CID-keyed font driver"
	default n
	depends on LIB_FREETYPE_AUX_MODULES_PSAUX
	depends on LIB_FREETYPE_AUX_MODULES_PSNAMES
	depends on LIB_FREETYPE_HINTING_MODULES_PSHINTER
	help
		This driver needs the `psaux', `pshinter', and `psnames' modules.

config LIB_FREETYPE_FONT_MODULES_PFR
	bool "PFR/TrueDoc font driver"
	default n
	help
		See optional extension ftpfr.c below also.

config LIB_FREETYPE_FONT_MODULES_TYPE42
	bool "PostScript Type 42 font driver"
	default n
	depends on LIB_FREETYPE_FONT_MODULES_TRUETYPE
	depends on LIB_FREETYPE_AUX_MODULES_PSAUX
	help
		This driver needs the `truetype' and `psaux' modules.

config LIB_FREETYPE_FONT_MODULES_WINFONTS
	bool "Windows FONT/FNT font driver"
	default n
	help
		See optional extension ftwinfnt.c below also.

config LIB_FREETYPE_FONT_MODULES_PCF
	bool "PCF font driver"
	default n
	help
		If debugging and tracing is enabled, needs `ftbitmap.c'.

config LIB_FREETYPE_FONT_MODULES_BDF
	bool "Enable BDF driver"
	default n
	help
		See optional extension ftbdf.c below also.

config LIB_FREETYPE_FONT_MODULES_SFNT
	bool "SFNT files support"
	default y
	depends on LIB_FREETYPE_AUX_MODULES_PSNAMES
	help
		If used without `truetype' or `cff', it supports bitmap-only fonts within an SFNT wrapper.
		This driver needs the `psnames' module.

endmenu # Font modules

menu "Hinting modules"

config LIB_FREETYPE_HINTING_MODULES_AUTOFIT
	bool "FreeType's auto hinter"
	default n

config LIB_FREETYPE_HINTING_MODULES_PSHINTER
	bool "PostScript hinter"
	default y

endmenu

menu "Raster modules"

config LIB_FREETYPE_RASTER_MODULES_RASTER
	bool "Monochrome rasterizer"
	default n

config LIB_FREETYPE_RASTER_MODULES_SMOOTH
	bool "Anti-aliasing rasterizer"
	default y

config LIB_FREETYPE_RASTER_MODULES_SDF
	bool "Signed distance field rasterizer"
	default n

endmenu # Hinting modules

menu "Auxiliary modules"

config LIB_FREETYPE_AUX_MODULES_CACHE
	bool "FreeType's cache sub-system"
	default n
	help
		FreeType's cache sub-system (quite stable but still in beta -- this means
		that its public API is subject to change if necessary).  See
		include/freetype/ftcache.h.  Needs `ftglyph.c'.

config LIB_FREETYPE_AUX_MODULES_GXVALID
	bool "TrueType GX/AAT table validation"
	default n
	help
		Needs `ftgxval.c' below.

config LIB_FREETYPE_AUX_MODULES_GZIP
	bool "Support for streams compressed with gzip (files with suffix .gz)"
	default y
	help
		See include/freetype/ftgzip.h for the API.

config LIB_FREETYPE_AUX_MODULES_LZW
	bool "Support for streams compressed with LZW (files with suffix .Z)"
	default n
	help
		See include/freetype/ftlzw.h for the API.

config LIB_FREETYPE_AUX_MODULES_BZIP2
	bool "Support for streams compressed with bzip2 (files with suffix .bz2)"
	default n
	help
		See include/freetype/ftbzip2.h for the API.

config LIB_FREETYPE_AUX_MODULES_OTVALID
	bool "OpenType table validation"
	default y
	help
		Needs `ftotval.c' below.

config LIB_FREETYPE_AUX_MODULES_PSAUX
	bool "Auxiliary PostScript driver component to share common code"
	default y
	depends on LIB_FREETYPE_AUX_MODULES_PSNAMES
	help
		This module depends on `psnames'.

config LIB_FREETYPE_AUX_MODULES_PSNAMES
	bool "Support for PostScript glyph names"
	default y
	help
		This module can be controlled in ftconfig.h
		(FT_CONFIG_OPTION_POSTSCRIPT_NAMES).

endmenu # Auxiliary modules

endif # LIB_FREETYPE
```

## glib/Kconfig
```kconfig
#
# For a description of the syntax of this configuration file,
# see the file kconfig-language.txt in the NuttX tools repository.
#

config LIB_GLIB
	bool "GLib library"
	depends on LIBC_EXECFUNCS
	default n
	---help---
		GLib is the low-level core library that forms the basis
		for projects such as GTK and GNOME.

if LIB_GLIB

endif
```

## googletest/Kconfig
```kconfig
#
# Copyright (C) 2020 Xiaomi Corporation
#
# Licensed under the Apache License, Version 2.0 (the "License");
# you may not use this file except in compliance with the License.
# You may obtain a copy of the License at
#
#      http://www.apache.org/licenses/LICENSE-2.0
#
# Unless required by applicable law or agreed to in writing, software
# distributed under the License is distributed on an "AS IS" BASIS,
# WITHOUT WARRANTIES OR CONDITIONS OF ANY KIND, either express or implied.
# See the License for the specific language governing permissions and
# limitations under the License.
#

config LIB_GOOGLETEST
	tristate "Google's C++ test framework"
	depends on LIBCXX
	depends on LIBC_NETDB
	depends on TLS_TASK_NELEM > 0
	depends on TLS_NELEM > 0
	default n

	---help---
		Enable googletest and googlemock

config UTILS_GTEST
	bool "Enable gtest"
	default n
	---help---
		Enable gtest utility

if UTILS_GTEST
config UTILS_GTEST_PROGNAME
	string "Programe Name"
	default "gtest"

config UTILS_GTEST_PRIORITY
	int "gtest utility priority"
	default 100

config UTILS_GTEST_STACKSIZE
	int "gtest utility statcksize"
	default DEFAULT_TASK_STACKSIZE
endif

config UTILS_GMOCK
	bool "Enable gmock"
	default n
	---help---
		Enable gmock utility

if UTILS_GMOCK
config UTILS_GMOCK_PROGNAME
	string "Programe Name"
	default "gmock"

config UTILS_GMOCK_PRIORITY
	int "gmock utility priority"
	default 100

config UTILS_GMOCK_STACKSIZE
	int "gmock utility statcksize"
	default DEFAULT_TASK_STACKSIZE
endif
```

## iperf2/Kconfig
```kconfig
#
# Copyright (C) 2020 Xiaomi Corporation
#
# Licensed under the Apache License, Version 2.0 (the "License");
# you may not use this file except in compliance with the License.
# You may obtain a copy of the License at
#
#      http://www.apache.org/licenses/LICENSE-2.0
#
# Unless required by applicable law or agreed to in writing, software
# distributed under the License is distributed on an "AS IS" BASIS,
# WITHOUT WARRANTIES OR CONDITIONS OF ANY KIND, either express or implied.
# See the License for the specific language governing permissions and
# limitations under the License.
#

menu "Tools: iperf2"

config TOOLS_IPERF2
	tristate "iperf2: ultimate speed test tool for TCP, UDP and SCTP"
	default n
	select HAVE_CXX
	select LIBC_FLOATINGPOINT
	---help---

if TOOLS_IPERF2

config TOOLS_IPERF2_PRIORITY
	int "iperf2 task priority"
	default 100

config TOOLS_IPERF2_STACKSIZE
	int "iperf2 stack size"
	default DEFAULT_TASK_STACKSIZE

config TOOLS_IPERF2_TCP_BUFSIZE
	int "iperf2 default TCP buffer size"
	default 16384

config TOOLS_IPERF2_DATA_REPORT_NUM
	int "iperf2 data report structure number"
	default 100

config TOOLS_IPERF2_RECV_BUFSIZE
	int "Net Receive buffer size"
	default 16384

endif

endmenu
```

## iperf3/Kconfig
```kconfig
#
# Copyright (C) 2020 Xiaomi Corporation
#
# Licensed under the Apache License, Version 2.0 (the "License");
# you may not use this file except in compliance with the License.
# You may obtain a copy of the License at
#
#      http://www.apache.org/licenses/LICENSE-2.0
#
# Unless required by applicable law or agreed to in writing, software
# distributed under the License is distributed on an "AS IS" BASIS,
# WITHOUT WARRANTIES OR CONDITIONS OF ANY KIND, either express or implied.
# See the License for the specific language governing permissions and
# limitations under the License.
#

menu "Tools: iperf3"

config UTILS_IPERF3
	tristate "iperf3"
	select DEV_URANDOM
	select FS_RAMMAP
	select LIBC_FLOATINGPOINT
	default n
	---help---
		Enable iperf3 tool.

if UTILS_IPERF3

config UTILS_IPERF3_PRIORITY
	int "iperf3 task priority"
	default 100
	---help---
		The priority for iperf3 task.

config UTILS_IPERF3_STACKSIZE
	int "iperf3 task stack size"
	default 4096
	---help---
		The stack size allocated for the iperf3 task.

endif # UTILS_IPERF

endmenu # Tools: iperf3
```

## kmgk/Kconfig
```kconfig
#
# For a description of the syntax of this configuration file,
# see the file kconfig-language.txt in the NuttX tools repository.
#

comment "Kmgk"

config TA_KEYSTORE
	bool "trusted application: KEYSTORE"
	default n
	depends on RTC
	---help---
		"GP TA: KEYSTORE"
```

## kmgk/defconfig
```kconfig
#
# Copyright (C) 2020-2022 Xiaomi Corporation
#
# Licensed under the Apache License, Version 2.0 (the "License");
# you may not use this file except in compliance with the License.
# You may obtain a copy of the License at
#
#      http://www.apache.org/licenses/LICENSE-2.0
#
# Unless required by applicable law or agreed to in writing, software
# distributed under the License is distributed on an "AS IS" BASIS,
# WITHOUT WARRANTIES OR CONDITIONS OF ANY KIND, either express or implied.
# See the License for the specific language governing permissions and
# limitations under the License.
#

#
# GP TEE API Debug Options
#
# CONFIG_TRACE_LEVEL_MSG is not set
# CONFIG_TRACE_LEVEL_ERROR is not set
# CONFIG_TRACE_LEVEL_INFO is not set
# CONFIG_TRACE_LEVEL_DEBUG=y
# CONFIG_TRACE_LEVEL_FLOW is not set

# trace level:
# 1 --> EMSG
# 2 --> IMSG
# 3 --> DMSG
# 4 --> FMSG
CONFIG_TRACE_LEVEL=1

# CONFIG_DEBUGLEVEL_ERROR is not set
# CONFIG_DEBUGLEVEL_INFO=y
# CONFIG_DEBUGLEVEL_DEBUG is not set
# CONFIG_DEBUGLEVEL_FLOW is not set
# CONFIG_DEBUGLEVEL=2

#
# System Type
#
CONFIG_SIM_PLAT=n
CONFIG_ARCH_CORTEX_M33=y
CONFIG_ARCH_FPU=y

#
# Toolchain Configuration Options
#
GCC_VERSION_9_2_2019Q4=y
CONFIG_GCC_VERSION="arm-none-eabi-9-2019-q4-major-x86_64-linux"
CONFIG_GCC_SITE="https://armkeil.blob.core.windows.net/developer/Files/downloads/gnu-rm/9-2019q4"
CONFIG_GCC_FOLDER="gcc-arm-none-eabi-9-2019-q4-major"

#
# Application Configuration
#

#
# Pseudo TAs:
#
CONFIG_APPS_HELLO_WORLD=y

#
# User TAs:
#
CONFIG_APPS_AES=y
CONFIG_APPS_HOTP=y

#
# Test suite:
#
CONFIG_APPS_TEST=y

#
# H/W Security exception:
#
CONFIG_APPS_HW_SECURITY_EXCEPTION_EXAMPLE=y
CONFIG_APPS_SPY=y

#
# file system storage dir
#
ifeq ($(strip $(CONFIG_SIM_PLAT)),y)
  #sim
  CONFIG_FS_STORAGE_DIR_PRIVATE='"/mnt/lfs/"'
else
  #best2003
  CONFIG_FS_STORAGE_DIR_PRIVATE='"/sst/"'
endif

CONFIG_FS_PLAINTEXT=n
#enabled output key meta for debug if yes
CONFIG_FS_DEBUG_KEY_MANAGER=n
CONFIG_FS_DEBUG_RPC_RAM=n
#enabled OTP root key if yes
CONFIG_OTP_ROOT_KEY_SUPPORT=y
#temporary compatible version without OPT root key if yes
CONFIG_OTP_SUPPORT_NO_PROVISION_TMP=y

CONFIG_USER_TA_WASM=y
CONFIG_WASM_HEAP_POOL=n

CONFIG_TRACE_PERF=n

CONFIG_PLAINTEXT_ERR_MSG=n

CONFIF_KM_RECV_BUF_SIZE=1024
```

## lcm/Kconfig
```kconfig
#
# For a description of the syntax of this configuration file,
# see the file kconfig-language.txt in the NuttX tools repository.
#

config LIB_LCM
	bool "lcm library"
	default n

if LIB_LCM

config LIB_LCM_TESTCASE
	tristate "lcm library passability test"
	default n
	---help---
		Used to check whether there will be any problems
		with the library running on NuttX

endif
```

## libchrome/Kconfig
```kconfig
#
# Copyright (C) 2020 Xiaomi Corporation
#
# Licensed under the Apache License, Version 2.0 (the "License");
# you may not use this file except in compliance with the License.
# You may obtain a copy of the License at
#
#      http://www.apache.org/licenses/LICENSE-2.0
#
# Unless required by applicable law or agreed to in writing, software
# distributed under the License is distributed on an "AS IS" BASIS,
# WITHOUT WARRANTIES OR CONDITIONS OF ANY KIND, either express or implied.
# See the License for the specific language governing permissions and
# limitations under the License.
#

menu "Middle Ware: Chromium general utility library"

config LIB_CHROMIUM
  bool "The Chromium general utility library"
  default n
  ---help---
    The Chromium project has an general utility library referred to as libbase.
    Because it is standalone and does not depend on any other parts of Chromium,
    it has been been picked up by other Google related projects so people don't
    have to reinvent these things.

if LIB_CHROMIUM

config CHROMIUM_LOG_LEVEL
  int "Chromium Debug Log Level"
  default 3
  help
    Sets log level for the Chromium Base library.

endif
endmenu
```

## libexpat/Kconfig
```kconfig
#
# Copyright (C) 2022 Xiaomi Corporation
#
# Licensed under the Apache License, Version 2.0 (the "License");
# you may not use this file except in compliance with the License.
# You may obtain a copy of the License at
#
#      http://www.apache.org/licenses/LICENSE-2.0
#
# Unless required by applicable law or agreed to in writing, software
# distributed under the License is distributed on an "AS IS" BASIS,
# WITHOUT WARRANTIES OR CONDITIONS OF ANY KIND, either express or implied.
# See the License for the specific language governing permissions and
# limitations under the License.
#

config LIB_EXPAT
	bool "Enable libexpat"
	default n
	---help---
		A C library for parsing XML

if LIB_EXPAT

config LIBEXPAT_TEST
    tristate "Enable Libexpat test"
    default n
    ---help---
        Enable the Libexpat test.

if LIBEXPAT_TEST

config LIBEXPAT_TEST_PRIORITY
    int "Libexpat test priority"
    default 100

config LIBEXPAT_TEST_STACKSIZE
    int "Libexpat test stack size"
    default DEFAULT_TASK_STACKSIZE

endif

endif
```
