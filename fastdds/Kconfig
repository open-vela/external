## fluoride/Kconfig
```kconfig
#
# Copyright (C) 2020 Xiaomi Corporation
#
# Licensed under the Apache License, Version 2.0 (the "License");
# you may not use this file except in compliance with the License.
# You may obtain a copy of the License at
#
#      http://www.apache.org/licenses/LICENSE-2.0
#
# Unless required by applicable law or agreed to in writing, software
# distributed under the License is distributed on an "AS IS" BASIS,
# WITHOUT WARRANTIES OR CONDITIONS OF ANY KIND, either express or implied.
# See the License for the specific language governing permissions and
# limitations under the License.
#

menu "Bluetooth Stack: Android Fluoride Bluetooth Stack"

menuconfig LIB_FLUORIDE
  bool "Android Fluoride Bluetooth stack"
  default n
  select CRYPTO
  select CRYPTO_RANDOM_POOL
  select EVENT_FD
  select DEV_URANDOM
  select DEV_URANDOM_RANDOM_POOL
  select LIB_CHROMIUM
  select LIB_TINYXML2
  select LIBC_SCANSET
  select NET_LOCAL_SCM
  help
    Enable support for the Fluoride Bluetooth stack

if LIB_FLUORIDE

config FLUORIDE_SERVICE_CLASS
  hex "Fluoride Service Class"
  default 0x20

config FLUORIDE_MAJOR_CLASS
  hex "Fluoride Major Class"
  default 0x40

config FLUORIDE_MINOR_CLASS
  hex "Fluoride Minor Class"
  default 0x08

config FLUORIDE_HCI_H4
  bool "H:4 UART"
  default n
  help
    Bluetooth H:4 UART driver. Requires hardware flow control
    lines to be available.

if FLUORIDE_HCI_H4

config FLUORIDE_HCI_UART_NAME
  string "Device Name of UART Device for Bluetooth"
  default "/dev/ttyBT"
  help
    This option specifies the name of UART device to be used
    for Bluetooth.

endif

config FLUORIDE_HCI_USB
  bool "H:2 USB"
  default n
  help
    Bluetooth H:2 USB driver.

config FLUORIDE_DEVICE_NAME
  string "Bluetooth device name"
  default "NuttX Fluoride"
  help
    Bluetooth device name.

config FLUORIDE_BLE_ENABLED
  bool "Enable Fluoride Bluetooth Low Energy"
  default y
  help
    Enable Fluoride Bluetooth Low Energy

config FLUORIDE_FILE_PATH
  string "Fluoride config path"
  default "/data/bt_config.conf"

config FLUORIDE_BACKUP_PATH
  string "Fluoride config backup path"
  default "/data/bt_config.bak"

config FLUORIDE_LEGACY_FILE_PATH
  string "Fluoride config backup path"
  default "/etc/init.d/bt_config.xml"

config FLUORIDE_BTE_DID_CONF_FILE
  string "Fluoride bte did config file"
  default "/etc/init.d/bt_did.conf"

config FLUORIDE_STACK_CONFIG_PATH
  string "Fluoride stack config path"
  default "/etc/init.d/bt_stack.conf"

config FLUORIDE_HCI_RX_STACKSIZE
  int "BT HCI RX thread stack size"
  default DEFAULT_TASK_STACKSIZE
  help
    Bluetooth HCI RX thread stack size.

config FLUORIDE_MAIN_STACKSIZE
  int "BT main thread stack size"
  default DEFAULT_TASK_STACKSIZE
  help
    Bluetooth main thread stack size.

config FLUORIDE_JNI_STACKSIZE
  int "BT JNI thread stack size"
  default DEFAULT_TASK_STACKSIZE
  help
    Bluetooth JNI thread stack size.

config FLUORIDE_HCI_STACKSIZE
  int "BT HCI thread stack size"
  default DEFAULT_TASK_STACKSIZE
  help
    Bluetooth HCI thread stack size.

config FLUORIDE_MANAGER_STACKSIZE
  int "BT manager thread stack size"
  default DEFAULT_TASK_STACKSIZE
  help
    Bluetooth manager thread stack size.

config FLUORIDE_A2DP_SINK_STACKSIZE
  int "BT a2dp sink thread stack size"
  default DEFAULT_TASK_STACKSIZE
  help
    Bluetooth a2dp sink thread stack size.

config FLUORIDE_A2DP_SOURCE_STACKSIZE
  int "BT a2dp source thread stack size"
  default DEFAULT_TASK_STACKSIZE
  help
    Bluetooth a2dp source thread stack size.

config FLUORIDE_ALARM_DISPATCHER_STACKSIZE
  int "BT alarm dispatcher thread stack size"
  default DEFAULT_TASK_STACKSIZE
  help
    Bluetooth alarm dispatcher thread stack size.

config FLUORIDE_ALARM_CALLBACK_STACKSIZE
  int "BT alarm callback thread stack size"
  default DEFAULT_TASK_STACKSIZE
  help
    Bluetooth alarm callback thread stack size.

config FLUORIDE_COMMAND_PENDING_TIMEOUT_MS
  int "Fluoride hci command pending timeout"
  default 10000
  ---help---
    set hci command pending timeout time

config FLUORIDE_LOG_LEVEL
  int "Fluoride Debug Log Level"
  default 4
  help
    Sets log level for the Fluoride stack.

config FLUORIDE_LOG_TRACE
  bool "Fluoride Trace log enable"
  default n
  help
    Sets log level for the Fluoride stack.

config BTA_AV_NUM_STRS
  int "Maximum number of streams created"
  default 2
  help
    Maximum number of streams created

config BTA_AG_MAX_NUM_CLIENTS
  int "Number of SCBs (AG service instances that can be registered)"
  default BTA_AV_NUM_STRS
  help
    Number of SCBs (AG service instances that can be registered)

config BTA_GATTC_KNOWN_SR_MAX
  int "Max known devices GATTC can support in Bluetooth spec."
  default 10
  help
    Max known devices GATTC can support in Bluetooth spec.

config BTA_GATTC_CL_MAX
  int "Max client application GATTC can support"
  default 2
  help
    Max client application GATTC can support

config BTA_GATTC_NOTIF_REG_MAX
  int "Max client application notifier can support"
  default 8
  help
    Max client application notifier can support

config BTA_DM_SDP_DB_SIZE
  int "Max DM SDP Database size"
  default 10240
  help
    Max DM SDP Database size

config BTA_AG_AT_MAX_LEN
  int "Maximum length of BTA AG AT"
  default 128
  help
    Maximum length of BTA AG AT.

config BTA_JV_SDP_DB_SIZE
  int "Maximum size of BTA JV SDP database"
  default 1024
  help
    Maximum size of BTA JV SDP database.

config BTA_SDP_DB_SIZE
  int "Maximum size of BTA SDP database"
  default 1024
  help
    Maximum size of BTA SDP database.

config BTA_JV_SDP_RAW_DATA_SIZE
  int "Maximum size of BTA JV SDP raw data"
  default 512
  help
    Maximum size of BTA JV SDP raw data.

config BTA_AV_SINK_INCLUDED
  bool "Enable Fluoride A2DP Sink SDP"
  default n
  help
    Enable Fluoride A2DP Sink SDP

config BTA_AV_RC_DISC_TIME_VAL
  int "Avrcp discovery timeout value"
  default 2500
  help
    Set avrcp discovery timeout value

config GATT_CL_MAX_LCB
  int "Max GATT CL LCB"
  default 8
  help
    Max GATT CL LCB

config GATT_MAX_PHY_CHANNEL
  int "Maximum number of GATT PHY channel count"
  default 2
  help
    Maximum number of GATT PHY channel count

config GATT_MAX_SR_PROFILES
  int "Maximum number of GATT SR profiles"
  default 8
  help
    Maximum number of GATT SR profiles

config GATT_MAX_APPS
  int "Maximum number of GATT Applications"
  default 8
  help
    Maximum number of GATT Applications

config BLE_LOCAL_PRIVACY_ENABLED
  bool "Enable Fluoride BLE privacy"
  default n
  help
    Enable Fluoride BLE privacy

config BLE_MAX_L2CAP_CLIENTS
  int "Maximum number of simultaneous applications that can register with LE"
  default 4
  help
    Maximum number of simultaneous applications that can register with LE

config HF_CLIENT_MAX_DEVICES
  int "Maximum number of HF devices supported simultaneously"
  default 2
  help
    Maximum number of HF devices supported simultaneously

config SDP_MAX_CONNECTIONS
  int "The maximum number of simultaneous client and server connections."
  default 8
  help
    The maximum number of simultaneous client and server connections.

config SDP_RAW_DATA_INCLUDED
  bool "Keep the raw data received from SDP server in database."
  default n
  help
    Keep the raw data received from SDP server in database.

config SDP_MAX_PAD_LEN
  int "The maximum number of SDP padding length."
  default 300
  help
    The maximum number of SDP padding length.

config BT_RC_NUM_APP
  int "Change this macro to use multiple RC"
  default BTA_AV_NUM_STRS
  help
    Change this macro to use multiple RC.

config AVDT_NUM_LINKS
  int "Number of simultaneous links to different peer devices."
  default BTA_AV_NUM_STRS
  help
    Number of simultaneous links to different peer devices.

config AVDT_NUM_SEPS
  int "Number of simultaneous stream endpoints."
  default BTA_AV_NUM_STRS
  help
    Number of simultaneous stream endpoints.

config AVDT_PROTECT_SIZE
  int "Maximum size in bytes of the content protection information element."
  default 16
  help
    Maximum size in bytes of the content protection information element.

config MAX_ACL_CONNECTIONS
  int "The maximum number of simultaneous links that ACL can support."
  default 2
  help
    The maximum number of simultaneous links that ACL can support.

config MAX_L2CAP_CHANNELS
  int "Maximum number of simultaneous channels that L2CAP can support."
  default 12
  help
    Maximum number of simultaneous channels that L2CAP can support.

config MAX_L2CAP_CLIENTS
  int "Maximum number of simultaneous applications that can register with L2CAP"
  default 10
  help
    Maximum number of simultaneous applications that can register with L2CAP.

config SDP_MAX_RECORDS
  int "The maximum number of SDP records the server can support."
  default 20
  help
    The maximum number of SDP records the server can support.

config SDP_MAX_REC_ATTR
  int "The maximum number of attributes in each record."
  default 25
  help
    The maximum number of attributes in each record.

config SDP_MAX_DISC_SERVER_RECS
  int "The maximum number of record handles retrieved in a search."
  default 10
  help
    The maximum number of record handles retrieved in a search.

config BTM_MAX_SCO_LINKS
  int "The number of SCO links."
  default 2
  help
    The number of SCO links.

config BD_NAME_LEN
  int "Maximum device name length."
  default 64
  help
    Maximum device name length.

config BTM_MAX_REM_BD_NAME_LEN
  int "Maximum device name length used in btm database."
  default 64
  help
    Maximum device name length used in btm database.

config BTM_MAX_LOC_BD_NAME_LEN
  int "Maximum local device name length stored btm database. "
  default 64
  help
    Maximum local device name length stored btm database.

config BTM_SEC_MAX_DEVICE_RECORDS
  int "The number of security records for peer devices."
  default 20
  help
    The number of security records for peer devices.

config BTM_SEC_MAX_SERVICE_RECORDS
  int "The number of security records for services."
  default 32
  help
    The number of security records for services.

config BTM_INQ_DB_SIZE
  int "The size in bytes of the BTM inquiry database."
  default 10
  help
    The size in bytes of the BTM inquiry database.

config BTM_LOCAL_IO_CAPS
  int "The IO capability of the local device (for Simple Pairing)."
  default 3
  help
    The IO capability of the local device (for Simple Pairing).

config BTM_LOCAL_IO_CAPS_BLE
  int "The IO capability of the local device (for BLE Simple Pairing)."
  default 3
  help
    The IO capability of the local device (for BLE Simple Pairing).

config MAX_RFC_CHANNEL
  int "Maximum number of RFCOMM channels."
  default 4
  help
    Maximum number of RFCOMM channels.

config MAX_RFC_PORTS
  int "Maximum number of ports supported."
  default 6
  help
    Maximum number of ports supported.

config GAP_MAX_CONNECTIONS
  int "Maximum number of simultaneous GAP L2CAP connections."
  default 5
  help
    Maximum number of simultaneous GAP L2CAP connections.

config BNEP_INCLUDED
  bool "Enable Fluoride BNEP support"
  default n
  help
    Enable Fluoride BNEP support

config BTA_PAN_INCLUDED
  bool "Enable Fluoride PAN support"
  default n
  help
    Enable Fluoride PAN support

config BTA_HH_INCLUDED
  bool "Enable Fluoride HID Host support"
  default n
  help
    Enable Fluoride HID Host support

config HID_HOST_MAX_DEVICES
  int "Maximum number of HID host devices"
  default 2
  help
    Maximum number of HID host devices.

config BTA_HD_INCLUDED
  bool "Enable Fluoride HID Device support"
  default n
  help
    Enable Fluoride HID Device support

config BTA_HEARING_AID_INCLUDED
  bool "Enable Fluoride Hearing aid support"
  default n
  help
    Enable Fluoride Hearing aid support

config SC_MODE_INCLUDED
  bool "4.1/4.2 secure connections feature"
  default n
  help
    The option of 4.1/4.2 secure connections feature

config AVRCP_DEFAULT_VERSION
  string "Fluoride default AVRCP Version"
  default "avrcp13"

config AVRCP_SERVICE
  bool "Fluoride new Avrcp service"
  default n

config AVCT_NUM_LINKS
  int "Maximum number of AVCTP links"
  default 4
  help
    Maximum number of AVCTP links.

config BT_DEFAULT_BUFFER_SIZE
  int "Fluoride default buffer Size"
  default 2064
  help
    Fluoride default buffer Size

config FLUORIDE_EXAMPLES
  bool "Enable Fluoride Examples"
  default n
  help
    Activate examples that provides Bluetooth commands to the
    console.

if FLUORIDE_EXAMPLES

config FLUORIDE_EXAMPLES_STACKSIZE
  int "Fluoride example stack size"
  default DEFAULT_TASK_STACKSIZE
  help
    Fluoride example stack size.

config FLUORIDE_EXAMPLES_A2DP_SINK
  bool "Enable Fluoride A2DP Sink Example"
  default y
  select BTA_AV_SINK_INCLUDED
  help
    Enable Fluoride A2DP Sink Example

config FLUORIDE_EXAMPLES_A2DP_SOURCE
  bool "Enable Fluoride A2DP SOURCE Example"
  default y
  help
    Enable Fluoride A2DP SOURCE Example

config FLUORIDE_EXAMPLES_RFCOMM
  bool "Enable Fluoride rfcomm Example"
  default y
  help
    Enable Fluoride rfcomm Example

if BTA_HD_INCLUDED

config FLUORIDE_EXAMPLES_HD_KEYBOARD
  bool "Enable Fluoride HID Device Keyboard support"
  default n
  help
    Enable Fluoride HID Device Keyboard support

config FLUORIDE_EXAMPLES_HD_MOUSE
  bool "Enable Fluoride HID Device Mouse support"
  default n
  help
    Enable Fluoride HID Device Mouse support

config FLUORIDE_EXAMPLES_HD_MEDIACTRL
  bool "Enable Fluoride HID Device Media Controller support"
  default n
  help
    Enable Fluoride HID Device Keyboard support

endif

if AUDIO && FLUORIDE_EXAMPLES_A2DP_SINK

config CODEC_SBC
  bool "Fluoride A2DP sink SBC codec"
  default n

choice
  prompt "Enable Fluoride A2DP Sink"
  default FLUORIDE_A2DP_SINK_NUTTX

config FLUORIDE_A2DP_SINK_NUTTX
  bool "Nuttx output"
  select CODEC_SBC
  help
    Enable Fluoride A2DP Sink Example

config FLUORIDE_A2DP_SINK_FFMPEG
  bool "FFMPEG output"
  help
    Enable Fluoride A2DP Sink FFMPEG output
endchoice

if FLUORIDE_A2DP_SINK_NUTTX

config FLUORIDE_A2DP_SINK_DEVNAME
  string "Fluoride Avrcp A2DP Sink Device Name"
  default "/dev/audio/pcm0p"

endif

endif

endif

endif

endmenu
```
