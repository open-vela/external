## libhelix-aac/Kconfig
```kconfig
#
# Copyright (C) 2021 Xiaomi Corporation
#
# Licensed under the Apache License, Version 2.0 (the "License");
# you may not use this file except in compliance with the License.
# You may obtain a copy of the License at
#
#      http://www.apache.org/licenses/LICENSE-2.0
#
# Unless required by applicable law or agreed to in writing, software
# distributed under the License is distributed on an "AS IS" BASIS,
# WITHOUT WARRANTIES OR CONDITIONS OF ANY KIND, either express or implied.
# See the License for the specific language governing permissions and
# limitations under the License.
#

menu "Helix Advanced Audio Codec"

config LIB_HELIX_AAC
	bool "The Helix Advanced Audio Codec Library"
	default n
	---help---
		Enable support for the Helix Advanced Audio Codec library

if LIB_HELIX_AAC

config LIB_HELIX_AAC_SBR
	bool "AAC-Spectral Band Replication"
	default n
	---help---
		Enable support for the AAC-PlusV1-SBR.

endif

endmenu
```

## libopencore-amr/Kconfig
```kconfig
#
# Copyright (C) 2023 Xiaomi Corporation
#
# Licensed under the Apache License, Version 2.0 (the "License");
# you may not use this file except in compliance with the License.
# You may obtain a copy of the License at
#
#      http://www.apache.org/licenses/LICENSE-2.0
#
# Unless required by applicable law or agreed to in writing, software
# distributed under the License is distributed on an "AS IS" BASIS,
# WITHOUT WARRANTIES OR CONDITIONS OF ANY KIND, either express or implied.
# See the License for the specific language governing permissions and
# limitations under the License.
#

menu "Opencore Amr Audio Codec"

config LIB_OPENCORE_AMR
	bool "The Opencore Amr Audio Codec Library"
	default n
	---help---
		Enable support for the Opencore Amr Audio Codec library

endmenu
```

## libpng/Kconfig
```kconfig
#
# Copyright (C) 2022 Xiaomi Corporation
#
# Licensed under the Apache License, Version 2.0 (the "License");
# you may not use this file except in compliance with the License.
# You may obtain a copy of the License at
#
#      http://www.apache.org/licenses/LICENSE-2.0
#
# Unless required by applicable law or agreed to in writing, software
# distributed under the License is distributed on an "AS IS" BASIS,
# WITHOUT WARRANTIES OR CONDITIONS OF ANY KIND, either express or implied.
# See the License for the specific language governing permissions and
# limitations under the License.
#

config LIB_PNG
	bool "Enable libpng"
	default n

if LIB_PNG

config LIB_PNG_TEST
	tristate "Enable the test of LIB_PNG"
	default n
	help
		Enable the LIB_PNG test.

if LIB_PNG_TEST

config LIB_PNG_TEST_PRIORITY
	int "LIB_PNG_TEST priority."
	default 100

config LIB_PNG_TEST_STACKSIZE
	int "LIB_PNG_TEST stacksize."
	default DEFAULT_TASK_STACKSIZE

endif

endif # LIB_PNG_TEST
```

## libssh/Kconfig
```kconfig
#
# Copyright (C) 2020 Xiaomi Corporation
#
# Licensed under the Apache License, Version 2.0 (the "License");
# you may not use this file except in compliance with the License.
# You may obtain a copy of the License at
#
#      http://www.apache.org/licenses/LICENSE-2.0
#
# Unless required by applicable law or agreed to in writing, software
# distributed under the License is distributed on an "AS IS" BASIS,
# WITHOUT WARRANTIES OR CONDITIONS OF ANY KIND, either express or implied.
# See the License for the specific language governing permissions and
# limitations under the License.
#

config LIB_SSH
	bool "Enable libssh"
	select LIBC_EXECFUNCS
	select PSEUDOTERM
	select SERIAL_TERMIOS
	depends on CRYPTO_MBEDTLS
	default n
	---help---
		a library for accessing ssh client services through C libraries calls in a simple manner.

config UTILS_SSH
	tristate "Enable ssh tool"
	depends on LIB_SSH
	---help---
		Enable ssh utility

if UTILS_SSH
config UTILS_SSH_PRIORITY
	int "ssh utility priority"
	default 100

config UTILS_SSH_STACKSIZE
	int "ssh utility statcksize"
	default 16384
endif
```

## libtar/Kconfig
```kconfig
#
# Copyright (C) 2020 Xiaomi Corporation
#
# Licensed under the Apache License, Version 2.0 (the "License");
# you may not use this file except in compliance with the License.
# You may obtain a copy of the License at
#
#      http://www.apache.org/licenses/LICENSE-2.0
#
# Unless required by applicable law or agreed to in writing, software
# distributed under the License is distributed on an "AS IS" BASIS,
# WITHOUT WARRANTIES OR CONDITIONS OF ANY KIND, either express or implied.
# See the License for the specific language governing permissions and
# limitations under the License.
#

config LIB_TAR
	bool "Tar library"
	default n
	select PSEUDOFS_SOFTLINKS
	---help---
		Enable support for tar

if LIB_TAR

config UTILS_TAR
	tristate "TAR tool"
	default n
	---help---
		Enable tar utility

if UTILS_TAR
config UTILS_TAR_PROGNAME
	string "Programe Name"
	default "tar"

config UTILS_TAR_PRIORITY
	int "tar utility priority"
	default 100

config UTILS_TAR_STACKSIZE
	int "tar utility statcksize"
	default 20480
endif

endif
```

## libxml2/Kconfig
```kconfig
#
# Copyright (C) 2020 Xiaomi Corporation
#
# Licensed under the Apache License, Version 2.0 (the "License");
# you may not use this file except in compliance with the License.
# You may obtain a copy of the License at
#
#      http://www.apache.org/licenses/LICENSE-2.0
#
# Unless required by applicable law or agreed to in writing, software
# distributed under the License is distributed on an "AS IS" BASIS,
# WITHOUT WARRANTIES OR CONDITIONS OF ANY KIND, either express or implied.
# See the License for the specific language governing permissions and
# limitations under the License.
#

menu "Middle Ware: LibXML2"

config LIB_XML2
	bool "Enable LibXML-2"
	default n
	---help---
		LibXML-2 is a simple, small, efficient, C XML parser that can be easily integrated into other programs.

endmenu # Middle Ware: LIBXML2
```

## lz4/Kconfig
```kconfig
#
# Copyright (C) 2020 Xiaomi Corporation
#
# Licensed under the Apache License, Version 2.0 (the "License");
# you may not use this file except in compliance with the License.
# You may obtain a copy of the License at
#
#      http://www.apache.org/licenses/LICENSE-2.0
#
# Unless required by applicable law or agreed to in writing, software
# distributed under the License is distributed on an "AS IS" BASIS,
# WITHOUT WARRANTIES OR CONDITIONS OF ANY KIND, either express or implied.
# See the License for the specific language governing permissions and
# limitations under the License.
#

config LIB_LZ4
	tristate "LZ4 compression library"
	default n

if LIB_LZ4

config UTILS_LZ4
	bool "LZ4 tool"
	default n
	---help---
		Enable lz4 utility

if UTILS_LZ4
config UTILS_LZ4_PROGNAME
	string "Programe Name"
	default "lz4"

config UTILS_LZ4_PRIORITY
	int "lz4 utility priority"
	default 100

config UTILS_LZ4_STACKSIZE
	int "lz4 utility statcksize"
	default DEFAULT_TASK_STACKSIZE
endif

endif
```

## mbedtls/Kconfig
```kconfig
#
# For a description of the syntax of this configuration file,
# see kconfig-language at https://www.kernel.org/doc/Documentation/kbuild/kconfig-language.txt
#

menu "Crypto: mbed tls library"

config LIB_MBEDTLS
	bool "The mbed tls library support"
	select DEV_URANDOM
	default n
	---help---
		Enable support for the mbed tls library

if LIB_MBEDTLS

config MBEDTLS_DEBUG_C
  bool "This module provides debugging functions."
  default n
  help
    This module provides debugging functions.

config MBEDTLS_SSL_MAX_CONTENT_LEN
  int "Maximum length (in bytes) of incoming and outgoing plaintext fragments."
  default 16384
  help
    Maximum length (in bytes) of incoming and outgoing plaintext fragments.

config MBEDTLS_SSL_SRV_C
  bool "This module is required for SSL/TLS server support."
  default n
  help
    This module is required for SSL/TLS server support.

config MBEDTLS_PLATFORM_MEMORY
  bool "Enable the memory allocation layer."
  default n
  help

config MBEDTLS_ENTROPY_HARDWARE_ALT
  bool "Uncomment this macro to let mbed TLS use your own implementation of a hardware entropy collector."
  default n
  help

config MBEDTLS_AES_ROM_TABLES
  bool "Store the AES tables in ROM."
  default n
  help

config MBEDTLS_REMOVE_ARC4_CIPHERSUITES
  bool "Remove RC4 ciphersuites by default in SSL / TLS."
  default y
  help

config MBEDTLS_NO_PLATFORM_ENTROPY
  bool "Do not use built-in platform entropy functions."
  default n
  help

config MBEDTLS_SELF_TEST
  bool "Enable the checkup functions (*_self_test)."
  default n
  help

config MBEDTLS_SSL_DTLS_CLIENT_PORT_REUSE
  bool "Enable server-side support for clients that reconnect from the same port."
  default y
  help

config MBEDTLS_BLOWFISH_C
  bool "Enable the Blowfish block cipher."
  default y
  help

config MBEDTLS_CAMELLIA_C
  bool "Enable the Camellia block cipher."
  default y
  help

config MBEDTLS_CERTS_C
  bool "Enable the test certificates."
  default y
  help

config MBEDTLS_PADLOCK_C
  bool "Enable VIA Padlock support on x86."
  default y
  help

config MBEDTLS_TIMING_C
  bool "Enable the semi-portable timing interface."
  default y
  help

config MBEDTLS_SSL_KEEP_PEER_CERTIFICATE
  bool "Enable the availability of the API mbedtls_ssl_get_peer_cert() giving access to the peer's certificate after completion of the handshake."
  default y
  help

config MBEDTLS_SSL_PROTO_DTLS
  bool "Enable support for DTLS (all available versions)."
  default y
  help

if MBEDTLS_SSL_PROTO_DTLS

config MBEDTLS_SSL_DTLS_ANTI_REPLAY
  bool "Enable support for the anti-replay mechanism in DTLS."
  default y
  help

config MBEDTLS_SSL_DTLS_HELLO_VERIFY
  bool "Enable support for HelloVerifyRequest on DTLS servers."
  default y
  help

config MBEDTLS_SSL_DTLS_BADMAC_LIMIT
  bool "Enable support for a limit of records with bad MAC."
  default y
  help

endif

config MBEDTLS_SSL_ALPN
  bool "Enable support for RFC 7301 Application Layer Protocol Negotiation."
  default y
  help

config MBEDTLS_AESNI_C
  bool "Enable AES-NI support on x86-64."
  default y
  help

config MBEDTLS_ECP_WINDOW_SIZE
  int "Maximum window size used"
  default 6
  help

config MBEDTLS_ECP_FIXED_POINT_OPTIM
  bool "Enable fixed-point speed-up"
  default y
  help

config MBEDTLS_CMAC_C
  bool "Enable the CMAC (Cipher-based Message Authentication Code) mode for block"
  default n
  help

endif

endmenu
```

## mdns/Kconfig
```kconfig
#
# For a description of the syntax of this configuration file,
# see the file kconfig-language.txt in the NuttX tools repository.
#

config LIB_MDNS
	bool "Enable libmdns"
	default n
	---help---
		Enable the MDNS tool

if LIB_MDNS

config UTILS_MDNS
	tristate "Enable mdns tools"
	default n
	---help---
		Enable the MDNS tool
if UTILS_MDNS

config UTILS_MDNS_PROGNAME
        string "Mdns program name"
        default "mdns"
        ---help---
                This is the name of the program that will be used when the NSH ELF
                program is installed.

config UTILS_MDNS_PRIORITY
        int "Mdns task priority"
        default 100

config UTILS_MDNS_STACKSIZE
        int "Mdns stack size"
        default DEFAULT_TASK_STACKSIZE

endif

endif
```

## mmc-utils/Kconfig
```kconfig
#
# For a description of the syntax of this configuration file,
# see the file kconfig-language.txt in the NuttX tools repository.
#

config UTILS_MMC
	bool "MMC tools"
	default n
	---help---
		mmc-utils is a tool for configuring MMC
		storage devices from userspace.
```

## mtp-responder/Kconfig
```kconfig
#
# For a description of the syntax of this configuration file,
# see the file kconfig-language.txt in the NuttX tools repository.
#

config MTP_RESPONDER
	tristate "MTP-responder"
	default n
	---help---
		The MTP-Responder allows files to be transferred to
		and from devices through the devices USB port.

if MTP_RESPONDER

config MTP_RESPONDER_PRIORITY
	int "MTP-responder task priority"
	default 100

config MTP_RESPONDER_THREAD_PRIORITY
	int "MTP-responder thread priority"
	default 100

config MTP_RESPONDER_STACKSIZE
	int "MTP-responder stack size"
	default DEFAULT_TASK_STACKSIZE

config MTP_RESPONDER_DEVICE_NAME
	string "The device name that display on pc"
	default "MTP Device"

config MTP_RESPONDER_INTRERNAL_STORAGE_PATH
	string "The path of Internal storage in device"
	default "/log/"

config MTP_RESPONDER_INTRERNAL_STORAGE_LOCK_ON
	bool "Internal storage lock state of device, default on"
	default y
	---help---
		The locked status of the device will affect whether
		the Interrnal storage(MTP_INTERNAL_PATH_CHAR) is
		mounted and displayed by the PC.

config MTP_RESPONDER_EXTERNAL_STORAGE_RESERVED_SPACE
	int "External storage reserved space, unit in MB"
	default "1024"
	---help---
		Used to reserve emmc space for the system to prevent
		the PC from filling up the device storage through the
		MTP service.

config MTP_RESPONDER_EXTERNAL_STORYAGE_DIRECTORY_LIST
	string "A first-level directory list of external storage"
	default ""
	---help---
		A first-level directory list of external storage on
		the device that can be displayed on the PC side through
		the MTP service.

config MTP_RESPONDER_ICON_PATH
	string "The path of icon can be displayed on the pc"
	default ""
	---help---
		The path of icon can be displayed on the pc.

config MTP_RESPONDER_OP_COPYOBJECT_ENABLE
	bool "Enable operation CopyObject"
	default n

endif
```
