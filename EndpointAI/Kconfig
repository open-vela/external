## coremark-pro/Kconfig
```kconfig
#
# Licensed to the Apache Software Foundation (ASF) under one or more
# contributor license agreements.  See the NOTICE file distributed with
# this work for additional information regarding copyright ownership.  The
# ASF licenses this file to you under the Apache License, Version 2.0 (the
# "License"); you may not use this file except in compliance with the
# License.  You may obtain a copy of the License at
#
#   http://www.apache.org/licenses/LICENSE-2.0
#
# Unless required by applicable law or agreed to in writing, software
# distributed under the License is distributed on an "AS IS" BASIS, WITHOUT
# WARRANTIES OR CONDITIONS OF ANY KIND, either express or implied.  See the
# License for the specific language governing permissions and limitations
# under the License.
#

menuconfig BENCHMARK_COREMARK_PRO
	bool "Coremark Pro Benchmark"
	default n
	depends on LIBC_FLOATINGPOINT

if BENCHMARK_COREMARK_PRO

config COREMARK_PRO_STACKSIZE
	int "Coremark Pro stack size"
	default 131072

config COREMARK_PRO_PRIORITY
	int "Coremark Pro priority"
	default 100

config COREMARK_PRO_USE_SINGLE_CONTEXT
	bool "use single context"
	default n

config COREMARK_PRO_SMP
	bool "Relevant configurations in case of SMP"
	default n
	depends on SMP && !COREMARK_PRO_USE_SINGLE_CONTEXT

config COREMARK_PRO_64BIT
	bool "Running on 64-bit operating systems"
	default n

config COREMARK_PRO_USE_FP64
	bool "USE FP64 Data for Test"
	default n

config COREMARK_PRO_CORE_TEST
	bool "Core Test"
	default n

config COREMARK_PRO_CJPEG_TEST
	bool "cjpeg-rose7-preset"
	default n
	---help---
		Before using this case, place the files in coremark-pro/benchmarks/libbmp
		and coremark-pro/benchmarks/libjpeg in /data/libbmp and /data/libjpeg
		respectively

config COREMARK_PRO_LINEAR_ALG_MID_TEST
	bool "Linear_alg_mid TEST"
	default n

config COREMARK_PRO_SHA_TEST
	bool "SHA Test"
	default n

config COREMARK_PRO_ZIP_TEST
	bool "Zip Test"
	depends on LIB_ZLIB
	default n

choice
	prompt "Coremark Pro FP Test Case configuration"
	default COREMARK_PRO_RADIX_TEST

config COREMARK_PRO_RADIX_TEST
	bool "Radix Test"

config COREMARK_PRO_LOOPS_ALL_MID_TEST
	bool "Loops-all-mid test"

config COREMARK_PRO_NNET_TEST
	bool "Nnet Test"

config COREMARK_PRO_PARSER_125K
	bool "Parser 125K Test"

endchoice

endif
```

## coremark/Kconfig
```kconfig
#
# For a description of the syntax of this configuration file,
# see the file kconfig-language.txt in the NuttX tools repository.
#

config UTILS_COREMARK
	tristate "CoreMark Processor Benchmark"
	default n
	---help---
		Enable the CoreMark Processor Benchmark

if UTILS_COREMARK

config UTILS_COREMARK_PRIORITY
	int "CoreMark task priority"
	default 100

config UTILS_COREMARK_STACKSIZE
	int "CoreMark stack size"
	default DEFAULT_TASK_STACKSIZE

config UTILS_COREMARK_ITERATIONS
	int "CoreMark iterations loop counter"
	default 0

config UTILS_COREMARK_SEED_METHOD
	int "CoreMark Seed Method"
	default 2 if UTILS_COREMARK_RUN_METHOD
	default 0 if !UTILS_COREMARK_RUN_METHOD
	---help---
		Set CoreMark Seed Method:
		0 : SEED_ARG
		1 : SEED_FUNC
		2 : SEED_VOLATILE

config UTILS_COREMARK_MEM_METHOD
	int "CoreMark Memory Method"
	default 1
	---help---
		Set CoreMark Memory Method:
		0 : MEM_STATIC
		1 : MEM_MALLOC
		2 : MEM_STACK

config UTILS_COREMARK_DEBUG
	int "CoreMark Core Debug"
	default 0
	---help---
		Enable the Core Debug:
		0 : Disable
		1 : Enable

config UTILS_COREMARK_RUN_METHOD
	int "CoreMark Run Method"
	default 0
	---help---
		Enable the Run Method:
		0 : VALIDATION_RUN
		1 : PERFORMANCE_RUN
		2 : PROFILE_RUN

config UTILS_COREMARK_MULTITHREAD
	int "CoreMark Multithread counter"
	default 1

endif
```

## cpp-toml/Kconfig
```kconfig
#
# For a description of the syntax of this configuration file,
# see the file kconfig-language.txt in the NuttX tools repository.
#

config LIB_CPPTOML
	bool "cpp-toml library"
	default n

if LIB_CPPTOML

config LIB_CPPTOML_TESTCASE
	tristate "cpp-toml library passability test"
	default n
	---help---
		Used to check whether there will be any problems
		with the library running on NuttX

endif
```

## curl/Kconfig
```kconfig
#
# Copyright (C) 2020 Xiaomi Corporation
#
# Licensed under the Apache License, Version 2.0 (the "License");
# you may not use this file except in compliance with the License.
# You may obtain a copy of the License at
#
#      http://www.apache.org/licenses/LICENSE-2.0
#
# Unless required by applicable law or agreed to in writing, software
# distributed under the License is distributed on an "AS IS" BASIS,
# WITHOUT WARRANTIES OR CONDITIONS OF ANY KIND, either express or implied.
# See the License for the specific language governing permissions and
# limitations under the License.
#

config LIB_CURL
	bool "Enable libcurl"
	select LIBC_LOCALTIME
	select LIBC_SCANSET
	depends on LIB_ZLIB
	depends on CRYPTO_MBEDTLS
	default n
	---help---
		libcurl

if LIB_CURL

config LIB_CURL_CA_PATH
	string "Curl Certificate Authorize PATH"
	default "/etc/ssl/curl"

config LIB_CURL_PTHREAD_STACKSIZE
	int "libcurl pthread stack size"
	default 6144
	---help---
		Stack size to use libcurl thread.

endif

config UTILS_CURL
	tristate "Enable curl command line"
	select LIB_CURL
	default n
	---help---
		curl

if UTILS_CURL

config UTILS_CURL_PROGNAME
	string "Program name"
	default "curl"
	---help---
		This is the name of the program that will be used when the NSH ELF
		program is installed.

config UTILS_CURL_PRIORITY
	int "curl task priority"
	default 100

config UTILS_CURL_STACKSIZE
	int "curl stack size"
	default 8192

endif
```

## dbus/Kconfig
```kconfig
#
# Copyright (C) 2020 Xiaomi Corporation
#
# Licensed under the Apache License, Version 2.0 (the "License");
# you may not use this file except in compliance with the License.
# You may obtain a copy of the License at
#
#      http://www.apache.org/licenses/LICENSE-2.0
#
# Unless required by applicable law or agreed to in writing, software
# distributed under the License is distributed on an "AS IS" BASIS,
# WITHOUT WARRANTIES OR CONDITIONS OF ANY KIND, either express or implied.
# See the License for the specific language governing permissions and
# limitations under the License.
#

config LIB_DBUS
	tristate "D-bus library"
	default n
	---help---
		D-Bus is a simple system for interprocess communication and
		coordination.

if LIB_DBUS

config DBUS_DAEMON
	bool "Enable dbus daemon"
	default n
	depends on LIB_EXPAT
	---help---
		Message bus daemon.

config LIB_DBUS_PRIORITY
	int "Libdbus task priority"
	default 100

config LIB_DBUS_STACKSIZE
	int "Libdbus stack size"
	default 6144

config DBUS_SEND
	bool "Enable dbus_send tool"
	default n
	---help---
		Send a message to a message bus by dbus_send.

config DBUS_MONITOR
	bool "Enable dbus_monitor tool"
	default n
	---help---
		Debug probe to print message bus messages by dbus_monitor.

config DBUS_TEST_TOOL
	bool "Enable dbus_test_tool"
	default n
	---help---
		A multi-purpose tool for debugging and profiling D-Bus by dbus_test_tool.

config DBUS_UPDATE_ACTIVATION_ENVIRONMENT
	bool "Enable dbus_update_activation_environment tool"
	default n
	---help---
		Update environment used for D-Bus session services by
		dbus_update_activation_environment.

endif
```

## ddelta/Kconfig
```kconfig
#
# Copyright (C) 2023 Xiaomi Corporation
#
# Licensed under the Apache License, Version 2.0 (the "License");
# you may not use this file except in compliance with the License.
# You may obtain a copy of the License at
#
#      http://www.apache.org/licenses/LICENSE-2.0
#
# Unless required by applicable law or agreed to in writing, software
# distributed under the License is distributed on an "AS IS" BASIS,
# WITHOUT WARRANTIES OR CONDITIONS OF ANY KIND, either express or implied.
# See the License for the specific language governing permissions and
# limitations under the License.
#

config UTILS_DDELTA
	tristate "ddelta utils"
	default n
	---help---
		Enable support for ddelta utils

if UTILS_DDELTA
config UTILS_DDELTA_PRIORITY
	int "apply task priority"
	default 100

config UTILS_DDELTA_STACKSIZE
	int "apply stack size"
	default DEFAULT_TASK_STACKSIZE

endif
```

## dhrystone/Kconfig
```kconfig
#
# Copyright (C) 2020 Xiaomi Corporation
#
# Licensed under the Apache License, Version 2.0 (the "License");
# you may not use this file except in compliance with the License.
# You may obtain a copy of the License at
#
#      http://www.apache.org/licenses/LICENSE-2.0
#
# Unless required by applicable law or agreed to in writing, software
# distributed under the License is distributed on an "AS IS" BASIS,
# WITHOUT WARRANTIES OR CONDITIONS OF ANY KIND, either express or implied.
# See the License for the specific language governing permissions and
# limitations under the License.
#

config UTILS_DHRYSTONE
	tristate "utils_dhrystone"
	default n
	---help---
		Dhrystone is one of the most common benchmark programs
		for measuring the computing power of processors and is commonly
		used to measure the performance of integer computing on processors.

if UTILS_DHRYSTONE

config UTILS_DHRYSTONE_PROGNAME
	string "Program Name"
	default "utils_dhrystone"

config UTILS_DHRYSTONE_STACKSIZE
	int "utils dhrystone stack size"
	default DEFAULT_TASK_STACKSIZE

config UTILS_DHRYSTONE_PRIORITY
	int "Task PRIORITY"
	default 100

endif
```

## eigen/Kconfig
```kconfig
#
# For a description of the syntax of this configuration file,
# see the file kconfig-language.txt in the NuttX tools repository.
#

config LIB_EIGEN
	bool "Eigen library"
	default n

if LIB_EIGEN

config LIB_EIGEN_TESTCASE
	tristate "Eigen library passability test"
	default n
	---help---
		Used to check whether there will be any problems
		with the library running on NuttX

endif
```

## ell/Kconfig
```kconfig
#
# For a description of the syntax of this configuration file,
# see the file kconfig-language.txt in the NuttX tools repository.
#

config LIB_ELL
	bool "Embedded Linux library"
	default n
	---help---
		Embedded Linux library.

if LIB_ELL

endif
```

## erpc/Kconfig
```kconfig
#
# Copyright (C) 2024 Xiaomi Corporation
#
# Licensed under the Apache License, Version 2.0 (the "License");
# you may not use this file except in compliance with the License.
# You may obtain a copy of the License at
#
#      http://www.apache.org/licenses/LICENSE-2.0
#
# Unless required by applicable law or agreed to in writing, software
# distributed under the License is distributed on an "AS IS" BASIS,
# WITHOUT WARRANTIES OR CONDITIONS OF ANY KIND, either express or implied.
# See the License for the specific language governing permissions and
# limitations under the License.
#

config LIB_ERPC
	bool "Enable liberpc"
	default n
	---help---
		Enable the ERPC lib, whose source code comes from github

if LIB_ERPC

config ERPC_DEFAULT_BUFFER_SIZE
	int "erpc default transport buffer size"
	default 1024
	---help---
		The default buffer size used by transport layer, which should
		larger or equal than message length.

config ERPC_PRE_POST_ACTION
	bool "Enable pre post action"
	default n
	---help---
		Enable or disable the pre and post function called by server/client.

endif
```

## ethercat/Kconfig
```kconfig
#
# Copyright (C) 2024 Xiaomi Corporation
#
# Licensed under the Apache License, Version 2.0 (the "License");
# you may not use this file except in compliance with the License.
# You may obtain a copy of the License at
#
#	   http://www.apache.org/licenses/LICENSE-2.0
#
# Unless required by applicable law or agreed to in writing, software
# distributed under the License is distributed on an "AS IS" BASIS,
# WITHOUT WARRANTIES OR CONDITIONS OF ANY KIND, either express or implied.
# See the License for the specific language governing permissions and
# limitations under the License.
#

config ETHERCAT
	bool "Enable ethercat"
	default n
	---help---
	  ethercat

if ETHERCAT

config ETHERCAT_MASTER
	bool "Enable etherCAT master"
	default n

if ETHERCAT_MASTER

config ETHERCAT_MASTER_EXAMMPLE
	tristate "EtherCAT master example"
	default n

config ETHERCAT_MASTER_PROGNAME
	string "EtherCAT master program name"
	default "ethercat_master"
	---help---
	  This is the name of the etherCAT master.

config ETHERCAT_MASTER_PRIORITY
	int "EtherCAT master task priority"
	default 100

config ETHERCAT_MASTER_STACKSIZE
	int "EtherCAT master stack size"
	default DEFAULT_TASK_STACKSIZE

endif

config ETHERCAT_SLAVE
	bool "Enable etherCAT slave"
	default n

if ETHERCAT_SLAVE

config ETHERCAT_SLAVE_EXAMMPLE
	tristate "EtherCAT slave example"
	default n

config ETHERCAT_SLAVE_PROGNAME
	string "EtherCAT slave program name"
	default "ethercat_slave"
	---help---
	  This is the name of the etherCAT slave.

config ETHERCAT_SLAVE_PRIORITY
	int "EtherCAT slave task priority"
	default 100

config ETHERCAT_SLAVE_STACKSIZE
	int "EtherCAT slave stack size"
	default DEFAULT_TASK_STACKSIZE

endif

config ETHERCAT_TOOL
	tristate "Enable etherCAT tool"
	default n

if ETHERCAT_TOOL

config ETHERCAT_TOOL_PROGNAME
	string "EtherCAT tool program name"
	default "ethercat"
	---help---
	  This is the name of the etherCAT tool.

config ETHERCAT_TOOL_PRIORITY
	int "EtherCAT tool task priority"
	default 100

config ETHERCAT_TOOL_STACKSIZE
	int "EtherCAT tool stack size"
	default DEFAULT_TASK_STACKSIZE

config ETHERCAT_TOOL_ENABLE_EOE
	bool "Enable EtherCAT tool EOE"
	default n

endif

endif
```

## exfatprogs/Kconfig
```kconfig
#
# For a description of the syntax of this configuration file,
# see the file kconfig-language.txt in the NuttX tools repository.
#

config UTILS_EXFATPROGS
	tristate "Exfat userspace utilities"
	default n
	---help---
		Exfatprogs is created as an official userspace utilities
		that contain all of the standard utilities for creating and
		fixing and debugging exfat filesystem.

if UTILS_EXFATPROGS

config UTILS_EXFATPROGS_PRIORITY
	int "Exfatprogs utilities task priority"
	default 100

config UTILS_EXFATPROGS_STACKSIZE
	int "Exfatprogs utilities stack size"
	default DEFAULT_TASK_STACKSIZE

config UTILS_EXFATPROGS_DUMP
	bool "Dump exfat utilities"
	default n
	---help---
		Show on-disk information.

config UTILS_EXFATPROGS_LABEL
	bool "Get/Set volume label"
	default n
	---help---
		Get or Set volume label or serial.

config UTILS_EXFATPROGS_TUNE
	bool "Adjust tunable exfat parameters"
	default n
	---help---
		Adjust tunable filesystem parameters on an
		exFAT filesystem.

config UTILS_EXFATPROGS_MKFS
	bool "Build a exfat filesystem"
	default n
	---help---
		Build a exfat filesystem on a device or partition.

config UTILS_EXFATPROGS_FSCK
	bool "Check a exfat filesystem"
	default n
	---help---
		Check the consistency of exfat filesystem and
		optionally repair a corrupted device formatted by exfat.

endif
```
