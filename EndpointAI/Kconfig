## EndpointAI/Kconfig
```kconfig
#
# For a description of the syntax of this configuration file,
# see the file kconfig-language.txt in the NuttX tools repository.
#

menuconfig LIB_ARM2D
	bool "Arm-2D graphics library"
	default n
	select CMSIS
	select CMSIS_DSP
	---help---
		Enable support for the Arm-2D library.
```

## QuadProgpp/Kconfig
```kconfig
#
# For a description of the syntax of this configuration file,
# see the file kconfig-language.txt in the NuttX tools repository.
#

config LIB_QUADPROGPP
	bool "QuadProgpp library"
	default n

if LIB_QUADPROGPP

config LIB_QUADPROGPP_TESTCASE
	tristate "QuadProgpp library passability test"
	default n
	---help---
		Used to check whether there will be any problems
		with the library running on NuttX

endif
```

## android/Kconfig
```kconfig
#
# Copyright (C) 2023 Xiaomi Corporation
#
# Licensed under the Apache License, Version 2.0 (the "License");
# you may not use this file except in compliance with the License.
# You may obtain a copy of the License at
#
#      http://www.apache.org/licenses/LICENSE-2.0
#
# Unless required by applicable law or agreed to in writing, software
# distributed under the License is distributed on an "AS IS" BASIS,
# WITHOUT WARRANTIES OR CONDITIONS OF ANY KIND, either express or implied.
# See the License for the specific language governing permissions and
# limitations under the License.
#

config ANDROID
	bool "Enable Android compatible layer"
	depends on LIBCXX && KVDB
	select FS_LARGEFILE
	default n
	---help---
		Android compatible layer, including:
		libbase, libcutils and libutils

config ANDROID_BINDER
	tristate "Enable Android Binder"
	depends on ANDROID && TLS_TASK_NELEM > 0
	default n
	---help---
		Android binder, the codebase come from AOSP

config ANDROID_BINDER_STACKSIZE
	int "Binder service stack size"
	depends on ANDROID_BINDER
	default DEFAULT_TASK_STACKSIZE
```

## android/binder/Kconfig
```kconfig
#
# Copyright (C) 2023 Xiaomi Corporation
#
# Licensed under the Apache License, Version 2.0 (the "License");
# you may not use this file except in compliance with the License.
# You may obtain a copy of the License at
#
#      http://www.apache.org/licenses/LICENSE-2.0
#
# Unless required by applicable law or agreed to in writing, software
# distributed under the License is distributed on an "AS IS" BASIS,
# WITHOUT WARRANTIES OR CONDITIONS OF ANY KIND, either express or implied.
# See the License for the specific language governing permissions and
# limitations under the License.
#

config ANDROID_BINDER
	bool "Enable Android Binder"
	depends on ANDROID && TIMER_FD && TLS_TASK_NELEM > 0
	default n
	---help---
		Android binder, the codebase come from AOSP

config ANDROID_BINDER_TEST
	tristate "Android Binder Test Case"
	depends on ANDROID_BINDER
	default n

config ANDROID_BINDER_TEST_STACKSIZE
	int "Android Binder Test stack size"
	depends on ANDROID_BINDER_TEST
	default DEFAULT_TASK_STACKSIZE

config ANDROID_BINDER_LIB_TEST
	bool "Android Binder Lib Test Case"
	depends on ANDROID_BINDER_TEST
	default n

config ANDROID_BINDER_DRIVER_TEST
	bool "Android Binder Driver Test Case"
	depends on ANDROID_BINDER_TEST
	default n

source "$APPSDIR/external/android/binder/cmds/Kconfig"
source "$APPSDIR/external/android/binder/examples/Kconfig"
```

## android/system/chre/Kconfig
```kconfig
#
# Copyright (C) 2023 Xiaomi Corporation
#
# Licensed under the Apache License, Version 2.0 (the "License");
# you may not use this file except in compliance with the License.
# You may obtain a copy of the License at
#
#      http://www.apache.org/licenses/LICENSE-2.0
#
# Unless required by applicable law or agreed to in writing, software
# distributed under the License is distributed on an "AS IS" BASIS,
# WITHOUT WARRANTIES OR CONDITIONS OF ANY KIND, either express or implied.
# See the License for the specific language governing permissions and
# limitations under the License.
#

config CHRE
	tristate "Context Hub Runtime Environment"
	default n
	depends on HAVE_CXX
	depends on LIBC_DLFCN
	---help---
		Enable Context Hub Runtime Environment (CHRE)

if CHRE

config CHRE_PROGNAME
	string "Program name of CHRE framework"
	default "chred"

config CHRE_PRIORITY
	int "Priority of CHRE"
	default 100

config CHRE_STACKSIZE
	int "Stack size of CHRE"
	default 8192

config CHRE_CLI_APP_MAX
	int "Max number of CLI param"
	default 8

config CHRE_APP_SPAMMER_USLEEP
	int "Suspend time(microseconds) used by apps/spammer"
	default 1

config CHRE_MESSAGE_TO_HOST_MAX_SIZE
	int "Maximum size of message sent to host(in bytes)"
	default 2048

config CHRE_AUDIO_SUPPORT_ENABLED
	bool "Audio support"
	default n
	---help---
		Audio support

config CHRE_BLE_SUPPORT_ENABLED
	bool "BLE support"
	default n
	---help---
		BLE support

config CHRE_GNSS_SUPPORT_ENABLED
	bool "GNSS support"
	default n
	---help---
		GNSS support

config CHRE_SENSORS_SUPPORT_ENABLED
	bool "Sensors support"
	default n
	---help---
		Sensors support

config CHRE_WIFI_SUPPORT_ENABLED
	bool "WIFI support"
	default n
	---help---
		WIFI support

config CHRE_WIFI_NAN_SUPPORT_ENABLED
	bool "WIFI NAN suport"
	default n
	---help---
		WIFI NAN suport

config CHRE_WWAN_SUPPORT_ENABLED
	bool "WWAN support"
	default n
	---help---
		WWAN support

config CHRE_UNIT_TEST
	bool "CHRE Unit Test"
	default n
	depends on LIB_GOOGLETEST
	---help---
		CHRE Unit Test

if CHRE_UNIT_TEST

config CHRE_UNIT_TEST_PROGNAME
	string "Program name"
	default "chre_test"

config CHRE_UNIT_TEST_PRIORITY
	int "Priority"
	default 100

config CHRE_UNIT_TEST_STACKSIZE
	int "Stack size"
	default 12288

endif #CHRE_UNIT_TEST

config CHRE_EXAMPLES
	bool "CHRE examples"
	default n

if CHRE_EXAMPLES

config CHRE_EXAMPLES_ALL
	bool "Enable all examples"
	default n
	select CHRE_EXAMPLES_HELLO_WORLD
	select CHRE_EXAMPLES_TIMER_WORLD
	select CHRE_EXAMPLES_HOST_ASAKE_WORKD
	select CHRE_EXAMPLES_BLE_WORLD
	select CHRE_EXAMPLES_GNSS_WORLD
	select CHRE_EXAMPLES_MESSAGE_WORLD
	select CHRE_EXAMPLES_RPC_WORLD
	select CHRE_EXAMPLES_SENSOR_WORLD
	select CHRE_EXAMPLES_DEBUG_DUMP_WORLD
	select CHRE_EXAMPLES_AUDIO_WORLD
	select CHRE_EXAMPLES_TFLM_DEMO
	select CHRE_EXAMPLES_WWAN_WORLD
	select CHRE_EXAMPLES_AUDIO_STRESS_TEST
	select CHRE_EXAMPLES_WIFI_WORLD

config CHRE_EXAMPLES_HELLO_WORLD
	bool "hello_workd"
	default n

config CHRE_EXAMPLES_TIMER_WORLD
	bool "timer_world"
	default n

config CHRE_EXAMPLES_HOST_ASAKE_WORKD
	bool "host_awake_world"
	default n

config CHRE_EXAMPLES_BLE_WORLD
	bool "ble_world"
	depends on CHRE_BLE_SUPPORT_ENABLED
	default n

config CHRE_EXAMPLES_GNSS_WORLD
	bool "gnss_world"
	depends on CHRE_GNSS_SUPPORT_ENABLED
	default n

config CHRE_EXAMPLES_MESSAGE_WORLD
	bool "message_world"
	default n

config CHRE_EXAMPLES_RPC_WORLD
	bool "rpc_world"
	default n

config CHRE_EXAMPLES_SENSOR_WORLD
	bool "sensor_world"
	depends on CHRE_SENSORS_SUPPORT_ENABLED
	default n

config CHRE_EXAMPLES_DEBUG_DUMP_WORLD
	bool "debug_dump_world"
	default n

config CHRE_EXAMPLES_AUDIO_WORLD
	bool "audio_world"
	depends on CHRE_AUDIO_SUPPORT_ENABLED
	default n

config CHRE_EXAMPLES_TFLM_DEMO
	bool "tflm_demo"
	default n

config CHRE_EXAMPLES_WWAN_WORLD
	bool "wwan_world"
	depends on CHRE_WWAN_SUPPORT_ENABLED
	default n

config CHRE_EXAMPLES_AUDIO_STRESS_TEST
	bool "audio_stress_test"
	depends on CHRE_AUDIO_SUPPORT_ENABLED
	default n

config CHRE_EXAMPLES_WIFI_WORLD
	bool "wifi_world"
	depends on CHRE_WIFI_SUPPORT_ENABLED
	default n

endif #CHRE_EXAMPLES

endif # CHRE
```

## avb/Kconfig
```kconfig
#
# Copyright (C) 2023 Xiaomi Corporation
#
# Licensed under the Apache License, Version 2.0 (the "License");
# you may not use this file except in compliance with the License.
# You may obtain a copy of the License at
#
#      http://www.apache.org/licenses/LICENSE-2.0
#
# Unless required by applicable law or agreed to in writing, software
# distributed under the License is distributed on an "AS IS" BASIS,
# WITHOUT WARRANTIES OR CONDITIONS OF ANY KIND, either express or implied.
# See the License for the specific language governing permissions and
# limitations under the License.
#

config LIB_AVB
	bool "Enable libavb"
	default n
	---help---
		libavb

if LIB_AVB

config LIB_AVB_CRC32
	bool "Enable CRC32"
	default n
if LIB_AVB_CRC32
config LIB_AVB_CRC32_CRYPTODEV
	bool "Enable CRC32 Accelerator via /dev/crypto"
	depends on CRYPTO_CRYPTODEV
	default n
endif

config LIB_AVB_SHA256
	bool "Enable SHA256"
	default n
if LIB_AVB_SHA256
config LIB_AVB_ALGORITHM_TYPE_SHA256_RSA2048
	bool "Enable algorithm type SHA256_RSA2048"
	default n
config LIB_AVB_ALGORITHM_TYPE_SHA256_RSA4096
	bool "Enable algorithm type SHA256_RSA4096"
	default n
config LIB_AVB_ALGORITHM_TYPE_SHA256_RSA8192
	bool "Enable algorithm type SHA256_RSA8192"
	default n
config LIB_AVB_SHA256_CRYPTODEV
	bool "Enable SHA256 Accelerator via /dev/crypto"
	depends on CRYPTO_CRYPTODEV
	default n
endif

config LIB_AVB_SHA512
	bool "Enable SHA512"
	default n
if LIB_AVB_SHA512
config LIB_AVB_ALGORITHM_TYPE_SHA512_RSA2048
	bool "Enable algorithm type SHA512_RSA2048"
	default n
config LIB_AVB_ALGORITHM_TYPE_SHA512_RSA4096
	bool "Enable algorithm type SHA512_RSA4096"
	default n
config LIB_AVB_ALGORITHM_TYPE_SHA512_RSA8192
	bool "Enable algorithm type SHA512_RSA8192"
	default n
config LIB_AVB_SHA512_CRYPTODEV
	bool "Enable SHA512 Accelerator via /dev/crypto"
	depends on CRYPTO_CRYPTODEV
	default n
endif

config LIB_AVB_RSA_VERIFY_CRYPTODEV
	bool "Enable RSA Accelerator via /dev/crypto"
	depends on CRYPTO_CRYPTODEV
	default n

config LIB_AVB_FOOTER_SEARCH_BLKSIZE
	int "Block size of AVB Footer searching"
	default 0
	---help---
		Default zero disables AVB Footer searching(read last 64 bytes directly),
		set value greater than zero as searching step size to enable.

config LIB_AVB_BUF_SIZE
	int "Max buffer size (Bytes) for partition message digest calculation"
	default 65536
	---help---
		Zero means alloc memory of size of full partition.

config LIB_AVB_DISABLE_VERIFY
	bool "Disable RSA verify"
	default n
	---help---
		Disable RSA verify, check MD only.

endif
```

## benchtests/Kconfig
```kconfig
#
# Copyright (C) 2020 Xiaomi Corporation
#
# Licensed under the Apache License, Version 2.0 (the "License");
# you may not use this file except in compliance with the License.
# You may obtain a copy of the License at
#
#      http://www.apache.org/licenses/LICENSE-2.0
#
# Unless required by applicable law or agreed to in writing, software
# distributed under the License is distributed on an "AS IS" BASIS,
# WITHOUT WARRANTIES OR CONDITIONS OF ANY KIND, either express or implied.
# See the License for the specific language governing permissions and
# limitations under the License.
#

config BENCHTEST
	tristate "benchtest"
	default n
	depends on LIBC_EXECFUNCS

if BENCHTEST

config BENCHTEST_STACKSIZE
	int "benchtest stack size"
	default 8192

config BENCHTEST_PRIORITY
	int "benchtest priority"
	default 100

config BENCHTEST_DURATION
	int "benchtest duration"
	default 1

config BENCHTEST_STRING_TESTS
	tristate "Enable String / WString Test"
	default n
	---help---
		When enabling this option, ensure that the _start_impl section exists

choice
	prompt "Libc Benchtest String / WString Test Case configuration"
	default BENCHTEST_STRING
	depends on BENCHTEST_STRING_TESTS

config BENCHTEST_STRING
	bool "Build String Test"

config BENCHTEST_WSTRING
	bool "Build WString Test"

endchoice

endif
```
